## drivers/video/fbdev/broadcom/displays/Kconfig
```kconfig
config FB_BRCM_PANEL_WINTEK_WDF6448X
	tristate "Wintek LCD panel init support"
	depends on SPI
	help
	  LCD Panel used in BRCM's ENTPHN boards
```

## sound/soc/bcm/Kconfig
```kconfig
config SND_BCM2835_SOC_I2S
	tristate "SoC Audio support for the Broadcom BCM2835 I2S module"
	depends on ARCH_BCM2835 || COMPILE_TEST
	select SND_SOC_GENERIC_DMAENGINE_PCM
	select REGMAP_MMIO
	help
	  Say Y or M if you want to add support for codecs attached to
	  the BCM2835 I2S interface. You will also need
	  to select the audio interfaces to support below.

config SND_SOC_CYGNUS
	tristate "SoC platform audio for Broadcom Cygnus chips"
	depends on ARCH_BCM_CYGNUS || COMPILE_TEST
	depends on HAS_DMA
	help
	  Say Y if you want to add support for ASoC audio on Broadcom
	  Cygnus chips (bcm958300, bcm958305, bcm911360)

	  If you don't know what to do here, say N.

config SND_SOC_CYGNUS_AUD_BASE_MACHINE
	tristate "SoC Audio support for Broadcom Cygnus Audio Base system"
	depends on SND_SOC_CYGNUS
	select MFD_WM8994
	select SND_SOC_WM8994
	select SND_SOC_AK4385
	select SND_SOC_SPDIF
	select SND_SIMPLE_CARD_UTILS
	help
	  Say Y if you want to add support for Cygnus SoC Audio Base system.
	  This a reference design that consists of an "audio_sa" board mounted
	  on an "audio base" board. This audio base board has more io options
	  for audio. There is a WM8994 codec, a AK4385 codec and spdif output.

config SND_SOC_CYGNUS_VOIPPHONE_MACHINE
	tristate "SoC Audio support for Broadcom Cygnus enterprise VoIP phone"
	depends on SND_SOC_CYGNUS
	select SND_SOC_CS42L73
	select SND_SOC_CYPRESS_BT_VOICE
	help
	  Say Y if you want to add support for Cygnus SoC enterprise voip phone
	  reference board (bcm911360_entphn).
	  Attached to the Cygnus SoC are a CS42L73 codec and also an optional
	  Bluetooth module.
```
