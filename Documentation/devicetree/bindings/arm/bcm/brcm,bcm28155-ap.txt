## Documentation/devicetree/bindings/display/brcm,iproc-dsi.txt
```
Broadcom IPROC DSI Controller driver
------------------------------
Overview
This is the brcm DSI controller driver for iProc SOC family
which hooks itself onto the Linux standard framebuffer framework
and receives user space ioctl commands. It configures the DSI,
AXIPV and PV hardware blocks which transports the framebuffer
contents onto the dsi panel attached.
A series of instructions/commands are sent to the panel in the form of
short/long packets during initialisation, suspend and resume.

Required properties:
- compatible		: "brcm,iproc-dsi"
- dsic-crmu-syscon	: phandle of dsic_crmu syscon register
- id			: Display ID
- reg			: Four register sets listed below.
			MIPI DSI PHY Register set
			MIPI AXIPV Controller Register set
			MIPI PV Controller Register set
			MIPI DSI GENERIC PLL Register set
			Register to generate software Controlled
			external device(panel) reset
- reg-names		: Values are "dsi-phy", "axipv", "pv", "gen-pll"
- interrupts		: Interrupts for DSI, AXIPV and PV.
- clocks		: DSI controller's clock registered to mipipll clock
			framework and the channel registered.
- clock-names		: DSI controller's clock name.
- brcm,num-fb		: Number of FrameBuffers used.
- brcm,iproc-mipi-reg-errata : Boolean entry, when set indicates that the
			dsi pll and phy register value corruption errata exist
			in this device. Due to this errata, write enable for a
			register is asserted for more than a cycle. So if
			address changes in the next cycle, same data can get
			written to another register. When this entry is set
			register is read back after every write if it falls
			in the errata address range. To make sure address stay
			constant for at least two cycles so that we will not
			be corrupting any other register.

Example:

	dsi {
		compatible	= "brcm,iproc-dsi";
		id		= <0>;
		brcm,num-fb	= <3>;
		reg 		= <0x180c0000 0x80>,
					<0x180a9000 0x60>,
					<0x180a9400 0x40>,
					<0x180a9800 0x50>,
					<0x0301d074 0x04>;
		reg-names	= "dsi-phy", "axipv", "pv", "gen-pll",
					"crmu_ext_reset";
		interrupts 	= <GIC_SPI 158 IRQ_TYPE_LEVEL_HIGH>,
					<GIC_SPI 156 IRQ_TYPE_LEVEL_HIGH>,
					<GIC_SPI 159 IRQ_TYPE_LEVEL_HIGH>;
		clocks		= <&mipipll_clks 0>;
		clock-names	= "mipidsi_clk";
		brcm,iproc-mipi-reg-errata;
		status   	= "okay";
	};
```

## Documentation/devicetree/bindings/display/panel/brcm,wintek,wdf6448x.txt
```
Wintek WD-F6448X-EFLWc VGA TFT LCD panel

Required properties:
- compatible: should be "brcm,wintek,wdf6448x"
- lcd-pwr-en-gpio: power enable gpio
- lcd-reset-gpio: reset gpio
- lcd-init-sequence: panel init sequence in 16-bit format. Higher 8 bits is
  command byte and lower 8 bits is data byte.

Example:
        lcd_panel_spi@0 {
                compatible = "brcm,wintek,wdf6448x";
                reg = <0>;
                lcd-pwr-en-gpio = <&gpio_east 16 0>;
                lcd-reset-gpio = <&gpio_east 25 0>;
                lcd-init-sequence = /bits/ 16
                                <0x0203 0x06c2 0x0a11 0x0e8c
                                0x128b 0x1622 0x1a00 0x1e30
                                0x2208 0x2640 0x2a88 0x2e88
                                0x3220 0x3620 0x8203 0x86c2
                                0x8a11 0x8e8c 0x928b 0x9622
                                0x9a00 0x9e30 0xa208 0xa640
                                0xaa88 0xae88 0xb220 0xb620>;
        };
```

## Documentation/devicetree/bindings/dma/brcm,iproc-sba.txt
```
* Broadcom SBA RAID engine

Required properties:
- compatible: Should be "brcm,iproc-sba"
- brcm,max-pq-disks: Maximum number of PQ disks supported by SBA hardware
- brcm,max-requests: Maximum number of requests to be supported by SBA driver
- brcm,request-size: Size of request to be supported by SBA driver
- mboxes: List of phandle and mailbox channel specifiers

Example:

raid_mbox: mbox@67400000 {
	...
	#mbox-cells = <3>;
	...
};

raid0 {
	compatible = "brcm,iproc-sba";
	brcm,max-pq-disks = <30>;
	brcm,max-requests = <256>;
	brcm,request-size = <131072>;
	mboxes = <&raid_mbox 0 0x1 0xffff>,
		 <&raid_mbox 1 0x1 0xffff>,
		 <&raid_mbox 2 0x1 0xffff>,
		 <&raid_mbox 3 0x1 0xffff>,
		 <&raid_mbox 4 0x1 0xffff>,
		 <&raid_mbox 5 0x1 0xffff>,
		 <&raid_mbox 6 0x1 0xffff>,
		 <&raid_mbox 7 0x1 0xffff>;
};
```

## Documentation/devicetree/bindings/dma/dma-pubuf.txt
```
* User space mappable DMA buffer
* Ported from https://github.com/ikwzm/udmabuf
* 	branch: u-dma-buf-master
* 	SHA: 3af280a66d1483dfb20defd9a4ceb71a51fa750c
* 	Date: Nov 22, 2019

Required properties:
- compatible: should be "dma-pubuf"
- size: set the capacity of the DMA buffer in bytes

Optional properties:
- minor-number:
         valid range is 0 to 255, when not specified driver automatically
         assigns one appropriately
- device-name:
      The device name is determined as follow:
         1) If device-name property is specified, the value of device-name
            property is used.
         2) If device-name property is not present, and if minor-number
            property is specified, sprintf("udmabuf%d", minor-number) is used.
         3) If device-name and minor-number are not present then the
            name of the device tree is used as device name.
- sync-mode:
      Used to configure the behavior when it is opened with the O_SYNC flag.
         1) sync-mode=<1>: If O_SYNC is specified or sync-always property is
                           specified, CPU cache is disabled.
                           Otherwise CPU cache is enabled.
         2) sync-mode=<2>: If O_SYNC is specified or sync-always property is
                           specified, CPU cache is disabled but CPU uses
                           write-combine when writing data to DMA buffer
                           improves performance by combining multiple write
                           accesses. Otherwise CPU cache is enabled.
         3) sync-mode=<3>: If O_SYNC is specified or sync-always property is
                           specified, DMA coherency mode is used.
                           Otherwise CPU cache is enabled.
         Default is sync-mode = <1>
- sync-always:
      Used to specify that the operation specified by the sync-mode property
      will always be performed regardless of O_SYNC specification.
- sync-offset:
      It is used to set the start of the buffer range when manually controlling
      the cache of dmapubuf. When it is not specified, sync-offset is set to <0>
- sync-size:
      It is used to set the size of the buffer range when manually controlling
      the cache of dmapubuf. When it is not specified, sync-size is set to <0>.
- sync-direction:
      It is used to set the direction of DMA when manually controlling the cache
      of dmapubuf.
         sync-direction=<0>: DMA_BIDIRECTIONAL
         sync-direction=<1>: DMA_TO_DEVICE
         sync-direction=<2>: DMA_FROM_DEVICE
      By default sync-direction is set to <0>
- dma-coherent:
      It is used to indicate that coherency between DMA buffer and CPU cache can
      be guaranteed by hardware.
      When it is not specified, it indicates that coherency between DMA buffer
      and CPU cache can not be guaranteed by hardware.
- memory-region:
      Linux can specify the reserved memory area in the device tree. The kernel
      excludes normal memory allocation from the physical memory space specified
      by reserved-memory property. In order to access this reserved memory area,
      it is nessasary to use a general-purpose memory access driver such as
      /dev/mem, or associate it with the device driver in the device tree.

      By the memory-region property, the reserved memory area is associated
      with dmapubuf.


Example:
      reserved-memory {
		#address-cells = <2>;
		#size-cells = <2>;
		ranges;

		reservedbuf: buffer@580000000 {
			compatible = "shared-dma-pool";
			reg = <0x00000005 0x80000000 0x00000000 0x3FC00000>;
			reusable;
		};
      };

      dmapubuf0: dmapubuf@0x0 {
		compatible = "dma-pubuf";
		size = <0x100000>;
		device-name = "dmapubuf0";
		sync-mode = <2>;
		sync-always;
		dma-coherent;
		memory-region = <&reservedbuf>;
      };
```

## Documentation/devicetree/bindings/i2c/i2c-slave-bmc.txt
```
BMC Client Device Tree Bindings
-------------------------------------------------------------

Required properties:
	- compatible: Should be "i2c-slave-bmc".
	- reg       : I2C address of the device, and I2C_OWN_SLAVE_ADDRESS
		      (1 << 30) is used to mark addresses on which we listen
		      to be devices ourselves.
	- bmc-thermal-zone: name of thermal zone.

Examples:

&i2c1 {
	bmc@40000035 {
		compatible = "i2c-slave-bmc";
		reg = <0x40000035>;
		bmc-thermal-zone = "ihost0-thermal";
	};
};
```

## Documentation/devicetree/bindings/interrupt-controller/brcm,iproc-crmu-intc.txt
```
* Broadcom's iProc CRMU Interrupt Controller

The iProc CRMU Interrupt Controller driver handles interrupts generated by the
Cortex-M0 MCU processor. The driver determines the type of event and forwards
the interrupt to the appropriate IRQ domain.

Required properties:
- compatible: Must be "brcm,iproc-crmu-intc"
- reg: Defines the base address of 1) The MCU to CRMU mailbox and 2) The CRMU to
  iProc interrupt registers.
- interrupts: The IRQ of the mailbox controller.
- #interrupt-cells: Must be 1.
- interrupt-controller: Sets the device as an interrupt controller.
- mboxes: The mailbox channel used to communicate with the mailbox controller.

Example:

Shows how the CRMU GPIO controller configures an IRQ domain and sets the iProc
CRMU Interrupt controller as the interrupt parent. When AON GPIO interrupts are
generated they will be forwared to the CRMU GPIO controller for processing.

	mailbox: mailbox@03024024 {
		compatible = "brcm,iproc-mailbox";
		reg = <0x03024024 0x8>;
		#mbox-cells = <1>;
	};

	iproc_crmu_intc: interrupt-controller@0302402c {
		compatible = "brcm,iproc-crmu-intc";
		reg = <0x0302402c 0x8>,
		      <0x03024058 0xc>;
		interrupts = <GIC_SPI 138 IRQ_TYPE_LEVEL_HIGH>;
		#interrupt-cells = <1>;
		interrupt-controller;
		/* Mailbox channel used by controller. */
		mboxes = <&mailbox 3>;
	};

	gpio_crmu: gpio@03024800 {
		compatible = "brcm,cygnus-crmu-gpio";
		reg = <0x03024800 0x50>,
		      <0x03024008 0x18>;
		ngpios = <6>;
		#gpio-cells = <2>;
		gpio-controller;
		interrupt-controller;
		interrupt-parent = <&iproc_crmu_intc>;
		interrupts = <0>;
		mboxes = <&mailbox 1>;
	};
```

## Documentation/devicetree/bindings/leds/backlight/wintek,wd-f6448x-eflwc.txt
```
Wintek LCD Panel bindings
-----------------------------------------------

The Wintek LCD panel driver toggles GPIO to power and reset LCD panel,
then sends SPI sequences to initialize the panel.

Required properties:

	- compatible:        "wintek,wd-f6448x-eflwc"
	- reg:               SPI chip select number for the device
	- spi-max-frequency: Max SPI frequency to use
	- power-enable-gpio: GPIO to enable LCD panel power
	- reset-gpio:        GPIO to reset LCD panel

Example:

	panel@0 {
		compatible = "wintek,wd-f6448x-eflwc";
		spi-max-frequency = <500000>;
		reg = <0>;
		power-enable-gpio = <&gpio_asiu 64 0>;
		reset-gpio = <&gpio_asiu 68 0>;
	};
```

## Documentation/devicetree/bindings/mailbox/brcm,fs4-test.txt
```
Broadcom FlexSparx4 Test Client
===============================
The FlexSparx4 (FS4) offload engines are available on various iProc SoC
such as Pegasus and Stingray. These FS4 offload engines are accessible
via SoC specific ring manager hardware. The driver for SoC specific
ring manager hardware will be mailbox controller driver hence Broadcom
FlexSparx4 Test Client is a mailbox client which helps us exersice
or stress offload engine features via sysfs interface.

Required properties:
--------------------
- compatible:	Should be one of the following:
		"brcm,fs4-test-spu2"
		"brcm,fs4-test-sba-memcpy"
		"brcm,fs4-test-sba-xor"
		"brcm,fs4-test-sba-pq"
- mboxes:	List of phandle and mailbox channel specifiers

Optional properties:
--------------------
- reg:		Specifies base physical address and size of the offload
		engine registers. This is an optional attribute because
		offload engines are mostly programmed via ring manager
		hardware so we don't require to touch offload engine
		registers.

Example:
---------
crypto_mbox: mbox@67000000 {
	compatible = "brcm,flexdma-mbox";
	reg = <0x67000000 0x200000>;
	msi-parent = <&gic_its 0x7ffd>;
	#mbox-cells = <3>;
	dma-coherent;
};

spu2 {
	compatible = "brcm,fs4-test-spu2";
	reg = <0x672c0000 0x1000>,
	      <0x672c1000 0x1000>,
	      <0x672c2000 0x1000>,
	      <0x672c3000 0x1000>,
	      <0x672c4000 0x1000>,
	      <0x672c5000 0x1000>,
	      <0x672c6000 0x1000>,
	      <0x672c7000 0x1000>,
	      <0x672c8000 0x1000>,
	      <0x672c9000 0x1000>;
	mboxes = <&crypto_mbox 0 0x1 0xff00>,
		 <&crypto_mbox 1 0x1 0xff00>,
		 <&crypto_mbox 2 0x1 0xff00>,
		 <&crypto_mbox 3 0x1 0xff00>,
		 <&crypto_mbox 4 0x1 0xff00>,
		 <&crypto_mbox 5 0x1 0xff00>,
		 <&crypto_mbox 6 0x1 0xff00>,
		 <&crypto_mbox 7 0x1 0xff00>,
		 <&crypto_mbox 8 0x1 0xff00>,
		 <&crypto_mbox 9 0x1 0xff00>,
		 <&crypto_mbox 10 0x1 0xff00>,
		 <&crypto_mbox 11 0x1 0xff00>,
		 <&crypto_mbox 12 0x1 0xff00>,
		 <&crypto_mbox 13 0x1 0xff00>,
		 <&crypto_mbox 14 0x1 0xff00>,
		 <&crypto_mbox 15 0x1 0xff00>,
		 <&crypto_mbox 16 0x1 0xff00>,
		 <&crypto_mbox 17 0x1 0xff00>,
		 <&crypto_mbox 18 0x1 0xff00>,
		 <&crypto_mbox 19 0x1 0xff00>,
		 <&crypto_mbox 20 0x1 0xff00>,
		 <&crypto_mbox 21 0x1 0xff00>,
		 <&crypto_mbox 22 0x1 0xff00>,
		 <&crypto_mbox 23 0x1 0xff00>,
		 <&crypto_mbox 24 0x1 0xff00>,
		 <&crypto_mbox 25 0x1 0xff00>,
		 <&crypto_mbox 26 0x1 0xff00>,
		 <&crypto_mbox 27 0x1 0xff00>,
		 <&crypto_mbox 28 0x1 0xff00>,
		 <&crypto_mbox 29 0x1 0xff00>,
		 <&crypto_mbox 30 0x1 0xff00>,
		 <&crypto_mbox 31 0x1 0xff00>;
};

raid_mbox: mbox@67400000 {
	compatible = "brcm,flexdma-mbox";
	reg = <0x67400000 0x200000>;
	msi-parent = <&gic_its 0x7ffe>;
	#mbox-cells = <3>;
	dma-coherent;
};

raid_memcpy {
	compatible = "brcm,fs4-test-sba-memcpy";
	brcm,max-pq-disks = <30>;
	brcm,max-requests = <256>;
	brcm,request-size = <131072>;
	mboxes = <&raid_mbox 16 0x4 0xff00>,
		 <&raid_mbox 17 0x4 0xff00>,
		 <&raid_mbox 18 0x4 0xff00>,
		 <&raid_mbox 19 0x4 0xff00>,
		 <&raid_mbox 20 0x4 0xff00>,
		 <&raid_mbox 21 0x4 0xff00>,
		 <&raid_mbox 22 0x4 0xff00>,
		 <&raid_mbox 23 0x4 0xff00>;
};

raid_xor {
	compatible = "brcm,fs4-test-sba-xor";
	mboxes = <&raid_mbox 24 0x4 0xff00>,
		 <&raid_mbox 25 0x4 0xff00>,
		 <&raid_mbox 26 0x4 0xff00>,
		 <&raid_mbox 27 0x4 0xff00>,
		 <&raid_mbox 28 0x4 0xff00>,
		 <&raid_mbox 29 0x4 0xff00>,
		 <&raid_mbox 30 0x4 0xff00>,
		 <&raid_mbox 31 0x4 0xff00>;
};
```
