## Documentation/devicetree/bindings/arm/bcm/brcm,bcm28155-ap.txt
```
Broadcom BCM28155-ap device tree bindings
-------------------------------------------

Boards with the bcm281xx SoC family (which includes bcm11130, bcm11140,
bcm11351, bcm28145, bcm28155 SoCs) shall have the following properties:

Required root node property:
  - compatible: brcm,bcm28155-ap

Example:
	/ {
		model = "BCM28155 AP board";
		compatible = "brcm,bcm28155-ap";
		[...]
	}
```

## Documentation/devicetree/bindings/arm/bcm/brcm,cygnus-pm.txt
```
Broadcom Cygnus Power Management Device Tree Bindings

The Cygnus power management driver configures and communicates with the M0 to
provide power management on Cygnus SoC's. The M0 is a low-power co-processor
dedicated to power management. The co-processor is configured with information
about the always-on (AON) regulators which can vary between board variants.

Required properties:
- compatible: must be "brcm,cygnus-pm".
- reg: Defines the base addresses and length for ihost_scu_control, cru, and
    iproc_crmu.
- reg_names: Register names corresponding to 'reg'. Required: "scu", "crmu",
    "cru".
- mboxes: A phandle specifying the mailbox controller and channel used to
    communicate with the M0 processor.
- aon_regulators: A child node containing child aon_regulator nodes describing
    AON regulators, which need to be externally disabled while in certain PM
	states. The node has the following properties:

  Required properties:
  - gpio: gpio to use for enable control

  Optional properties:
  - startup-delay-us: Startup time in microseconds. If this property is missing,
      the default is 0.
  - enable-active-high: Polarity of GPIO is active high. If this property is
      missing, the default is active low.
  - regulator-state-standby: sub-root node for Standby. The device is in a
      power-saving state but can still receive certain events.
  - regulator-state-mem: sub-root node for Suspend-to-RAM (deepsleep). All data
      is stored in memory and only an external interrupt can wake the device.
  - regulator-state-off: sub-root node for Cygnus OFF mode. The core part of the
      device is powered off. Only an external interrupt can wake the
      co-processor. The device goes through a full boot on wakeup. If this node
	  is missing the regulator state is not modified upon entering and exiting
	  the corresponding PM state.
  - regulator-state-[standby/mem/off]: A node that has the following common
      properties:
      - regulator-off-in-suspend: regulator should be disabled by the PM
        co-processor while in the corresponding PM state. If this property is
	    missing the regulator state is not modified upon entering and exiting a
	    PM state.

Example:

	pm: pm@19020000 {
		compatible = "brcm,cygnus-pm";
		reg = <0x19020000 0x100>,
		      <0x03024024 0x7c>,
		      <0x1800e000 0x2000>;
		reg-names = "scu", "crmu", "cru";
		mboxes = <&mailbox 0>;

		aon_regulators {
			vdd_regulator {
				gpio = <&gpio_crmu 0 0>;
				enable-active-high;
				startup-delay-us = <1000>;
				regulator-state-mem {
					regulator-off-in-suspend;
				};
				regulator-state-off {
					regulator-off-in-suspend;
				};
			};
			rf_regulator0 {
				gpio = <&gpio_crmu 1 0>;
				enable-active-high;
				regulator-state-off {
					regulator-off-in-suspend;
				};
			};
			rf_regulator1 {
				gpio = <&gpio_crmu 2 0>;
				enable-active-high;
				regulator-state-off {
					regulator-off-in-suspend;
				};
			};
		};
	};
```

## Documentation/devicetree/bindings/arm/bcm/brcm,ns3z.txt
```
Broadcom NS3z device tree bindings
------------------------------------------------

Boards with NS3z shall have the following properties:

Required root node property:

NS3z SoC
compatible = "brcm,ns3z";
```

## Documentation/devicetree/bindings/arm/bcm/brcm,omega.txt
```
Broadcom Omega device tree bindings
------------------------------------------------

Boards with Omega SOC shall have the following properties:

Required root node property:

Omega SOC
compatible = "brcm,omega";
```

## Documentation/devicetree/bindings/arm/bcm/brcm,pegasus.txt
```
Broadcom Pegasus device tree bindings
------------------------------------------------

Boards with Pegasus SOC shall have the following properties:

Required root node property:

Pegasus SOC
compatible = "brcm,pegasus";
```

## Documentation/devicetree/bindings/arm/bcm/brcm,stingray.txt
```
Broadcom Stingray device tree bindings
------------------------------------------------

Boards with Stingray SOC shall have the following properties:

Required root node property:

Stingray SOC
compatible = "brcm,stingray";
```

## Documentation/devicetree/bindings/arm/bcm/brcm,valkyrie.txt
```
Broadcom Valkyrie device tree bindings
------------------------------------------------

Boards with Valkyrie shall have the following properties:

Required root node property:

Valkyrie SoC
compatible = "brcm,valkyrie";
```

## Documentation/devicetree/bindings/crypto/brcm,iproc-pka.txt
```
Broadcom iProc Public Key accelarator
-------------------------------------
PKA (Public Key accelarator) supports several public key
algorithms like RSA crypto system, Digital Signature
Algorithm, etc.

Required properties:
- compatible 	: "brcm,iproc-pka"
- reg 		: Base address of PKA_CONTROL_STATUS register.

Example:
	pka: iproc_pka@18031000 {
		compatible = "brcm,iproc-pka";
		reg = <0x18031000 0x10>;
	};
```

## Documentation/devicetree/bindings/crypto/brcm,spu-crypto.txt
```
The Broadcom Secure Processing Unit (SPU) hardware supports symmetric
cryptographic offload for Broadcom SoCs. A SoC may have multiple SPU hardware
blocks.

Required properties:
- compatible: Should be one of the following:
  brcm,spum-crypto - for devices with SPU-M hardware
  brcm,spu2-crypto - for devices with SPU2 hardware
  brcm,spu2-v2-crypto - for devices with enhanced SPU2 hardware features like SHA3
  and Rabin Fingerprint support
  brcm,spum-nsp-crypto - for the Northstar Plus variant of the SPU-M hardware

- reg: Should contain SPU registers location and length.
- mboxes: The mailbox channel to be used to communicate with the SPU.
  Mailbox channels correspond to DMA rings on the device. spu2-v2 based devices
  may have more DMA rings than the number of SPU hardware blocks and internally
  hardware schedules the assignment of DMA rings to SPU hardware blocks.

Example:
	crypto@612d0000 {
		compatible = "brcm,spum-crypto";
		reg = <0 0x612d0000 0 0x900>;
		mboxes = <&pdc0 0>;
	};

	spu2: spu2 {
		compatible = "brcm,spu2-v2-crypto";
		reg = <0x672c0000 0x1000>,
		      <0x672c1000 0x1000>,
		      <0x672c2000 0x1000>,
		      <0x672c3000 0x1000>,
		      <0x672c4000 0x1000>,
		      <0x672c5000 0x1000>,
		      <0x672c6000 0x1000>,
		      <0x672c7000 0x1000>,
		      <0x672c8000 0x1000>,
		      <0x672c9000 0x1000>;
		mboxes = <&crypto_mbox 0 0x1 0xff00>,
			 <&crypto_mbox 1 0x1 0xff00>,
			 <&crypto_mbox 2 0x1 0xff00>,
			 <&crypto_mbox 3 0x1 0xff00>,
			 <&crypto_mbox 4 0x1 0xff00>,
			 <&crypto_mbox 5 0x1 0xff00>,
			 <&crypto_mbox 6 0x1 0xff00>,
			 <&crypto_mbox 7 0x1 0xff00>,
			 <&crypto_mbox 8 0x1 0xff00>,
			 <&crypto_mbox 9 0x1 0xff00>,
			 <&crypto_mbox 10 0x1 0xff00>,
			 <&crypto_mbox 11 0x1 0xff00>,
			 <&crypto_mbox 12 0x1 0xff00>,
			 <&crypto_mbox 13 0x1 0xff00>,
			 <&crypto_mbox 14 0x1 0xff00>,
			 <&crypto_mbox 15 0x1 0xff00>,
			 <&crypto_mbox 16 0x1 0xff00>,
			 <&crypto_mbox 17 0x1 0xff00>,
			 <&crypto_mbox 18 0x1 0xff00>,
			 <&crypto_mbox 19 0x1 0xff00>,
			 <&crypto_mbox 20 0x1 0xff00>,
			 <&crypto_mbox 21 0x1 0xff00>,
			 <&crypto_mbox 22 0x1 0xff00>,
			 <&crypto_mbox 23 0x1 0xff00>,
			 <&crypto_mbox 24 0x1 0xff00>,
			 <&crypto_mbox 25 0x1 0xff00>,
			 <&crypto_mbox 26 0x1 0xff00>,
			 <&crypto_mbox 27 0x1 0xff00>,
			 <&crypto_mbox 28 0x1 0xff00>,
			 <&crypto_mbox 29 0x1 0xff00>,
			 <&crypto_mbox 30 0x1 0xff00>,
			 <&crypto_mbox 31 0x1 0xff00>;
	};
```

## Documentation/devicetree/bindings/display/brcm,iproc-dsi-panel.txt
```
DSI Panel Node For Broadcom DSI Driver
--------------------------------------

Required properties:
- brcm,module-name  	: The name of the display panel module.
- brcm,col-mod-i	: Input colour format (Refer enum DISPDRV_FB_FORMAT_T).
- brcm,col-mod-o	: Output colour format (Refer enum DISPDRV_FB_FORMAT_T).
- brcm,panel-width-mm	: Physical width of the panel.
- brcm,panel-height-mm	: Physical height of the panel.
- brcm,vmode		: If this parameter is present,then video mode is enabled.
			(Otherwise command mode).
- brcm,fps		: Frames per second expected.
- brcm,lanes		: Number of DSI data lanes to enable.
- brcm,cmd-lp		: Denotes whether the commands are sent in LP or HS mode.
			If this parameter is present, then the commands are sent
			in LP mode.
- brcm,hs-bitrate	: High-Speed data rate in bps.
- brcm,lp-bitrate	: Low-power data rate in bps.
- brcm,dsi-timing	: DSI Phy timing related information.
			Array of u32 elemnts for to calculating the following.

	1. DSI_C_ESC2LP_RATIO	: width of mark-1 and mark-0 states during
				LP data transmission in escape clock periods
	2. DSI_C_HS_INIT	: time required for the slave to enter RX_STOP
				and includes the initialization time of the
				slave in HS bit clock periods
	3. DSI_C_HS_WAKEUP	: minimum time interval before exiting ULPS
				mode in HS bit clock period
	4. DSI_C_LP_WAKEUP	: minimun time interval for recovering from ULPS
	5. DSI_C_HS_CLK_PRE	: minimum time interval of HS clock before data
				lane HS entry in HS bit clock period
	6. DSI_C_HS_CLK_PREPARE	: minimum time interval of LP-00 prior to
				HS-ZERO state in HS bit clock period
	7. DSI_C_HS_CLK_ZERO	: minimum time interval of HS -0 before HS clock
				in HS bit clock period
	8. DSI_C_HS_CLK_POST	: minimum time interval of HS clock after all
				data lanes enter LP stop in HS bit clock period
	9. DSI_C_HS_CLK_TRAIL	: minimum time interval of HS differential state
				of clock lane in HS bit clock period
	10. DSI_C_HS_LPX	: minimum time interval of any LP state in HS
				bit clock periods
	11. DSI_C_HS_PRE	: minimum time interval to drive LP-00 prior to
				the HS-Zero state in HS bit clock periods
	12. DSI_C_HS_ZERO	: minimum time interval to drive HS-0 prior to
				the sync sequence in HS bit clock periods
	13. DSI_C_HS_TRAIL	: minimum time interval to drive flipped state
				after last bit of HS data in HS bit clock period
	14. DSI_C_HS_EXIT	: minimum time interval of LP-11 state after a
				HS burst transmission in HS bit clock periods.
	15. DSI_C_LPX		: minimum time interval of any LP state in HS
				bit clock periods
	16. DSI_C_LP_TA_GO	: minimum time to drive LP-00 after turn request
	17. DSI_C_LP_TA_SURE	: minimun time to confirm bus turn around
	18. DSI_C_LP_TA_GET	: minimum time to drive LP-00 by new transmitter

	Each of the above will have 16 of the following u32 entries to
		calculate their values,
		type		: Type corresponding to each of the above
		time_base	: Gives the time base for the calculations,
				0 : DSI_C_TIME_ESC2LPDT
				1 : DSI_C_TIME_HS
				2 : DSI_C_TIME_ESC
		mode		: Counter mode flag
				1: Record has MAX value set
				2: record MIN value is MAX of 2 values
		time_lpx	: LP esc counters in LP LPX units (LP data clk unit)
		time_min1_ns	: Minimun1 time in ns
		time_min1_ui	: Minimum1 time in ui
		time_min2_ns	: Minimum2 time in ns
		time_min2_ui	: Minimum2 time in ui
		time_max_ns	: Maximum time in ns
		time_max_ui	: Maximum time in ui
		counter_min	: Minimum possible value of the counter
		counter_max	: Maximum possible value of the counter
		counter_step	: Counter step
		counter_offs	: Counter offset
		counter		: Counter value
		period		: Period

- brcm,scrn-on	: Panel on commands.
		Array of bytes where each command takes two bytes.
		First byte specifies the command type (Refer DSI DCS spec)
		Second byte is the actual command.
- brcm,scrn-off	: Panel off commands.
		Array of bytes where each command takes two bytes.
		First byte specifies the command type (Refer DSI DCS spec)
		Second byte is the actual command.
- brcm,slp-in	: Sleep in commands for the panel.
		Array of bytes where each command takes two bytes.
		First byte specifies the command type (Refer DSI DCS spec)
		Second byte is the actual command.
- brcm,slp-out	: Sleep out commands for the panel.
		Array of bytes where each command takes two bytes.
		First byte specifies the command type (Refer DSI DCS spec)
		Second byte is the actual command.
- brcm,init-panel: Panel initialization commands.
		Array of bytes where each command takes two bytes.
		First byte specifies the command type (Refer DSI DCS spec)
		Second byte is the actual command.
- panel-timing	: Display timing information (Refer to panel/display-timing.txt)

Example:

	dsi_panel {
		brcm,module-name = "HX8389B";
		brcm,col-mod-i = <3>;
		brcm,col-mod-o = <2>;
		brcm,panel-width-mm = <54>;
		brcm,panel-height-mm = <95>;
		brcm,vmode;
		brcm,fps = <60>;
		brcm,lanes = <2>;
		brcm,cmd-lp;
		brcm,hs-bitrate = <420000000>;
		brcm,lp-bitrate = <5000000>;

		brcm,dsi-timing = <0 0 0 0 00 00 00 00 00 0 0 0x0000003F 1 1 0 0
			1 1 0 0 1000000 00 00 00 00 0 0 0x00FFFFFF 0 0 0 0
			2 1 0 0 1000000 00 00 00 00 0 0 0x00FFFFFF 0 0 0 0
			3 2 0 0 1000000 00 00 00 00 0 0 0x00FFFFFF 1 1 0 0
			4 1 0 0 00 12 00 00 00 0 0 0x000001FF 0 0 0 0
			5 1 1 0 48 00 00 00 95 0 0 0x000001FF 0 0 0 0
			6 1 0 0 262 00 00 00 00 0 0 0x000001FF 0 0 0 0
			7 1 0 0 70 52 00 00 00 0 0 0x000001FF 0 0 0 0
			8 1 0 0 70 00 00 00 00 0 0 0x000001FF 0 0 0 0
			9 1 0 0 60 00 00 00 75 0 0 0x000001FF 0 0 0 0
			10 1 1 0 50 04 00 00 85 6 0 0x000001FF 0 0 0 0
			11 1 0 0 105 06 00 00 00 0 0 0x000001FF 0 0 0 0
			12 1 2 0 0 32 60 16 00 0 0 0x000001FF 0 0 0 0
			13 1 0 0 110 00 00 00 00 0 0 0x000001FF 0 0 0 0
			14 2 0 1 0 00 00 00 00 0 0 0x000000FF 1 1 0 0
			15 2 0 4 0 00 00 00 00 0 0 0x000000FF 1 1 0 0
			16 2 0 2 0 00 00 00 00 0 0 0x000000FF 1 1 0 0
			17 2 0 5 0 00 00 00 00 0 0 0x000000FF 1 1 0 0>;

		brcm,scrn-on = [ 01 29
				00 00 ];
		brcm,scrn-off = [ 01 28
				00 00 ];
		brcm,slp-in = [ 01 28
				01 10
				04 78
				00 00 ];
		brcm,slp-out = [ 01 11
				04 78
				00 00 ];
		brcm,init-panel = [ 01 B9
				03 FF
				03 83
				03 89
				01 B1
				00 00 ];

		panel-timing {
			clock-frequency = <17239800>;
			hactive = <540>;
			vactive = <960>;
			hfront-porch = <22>;
			hback-porch = <20>;
			hsync-len = <8>;
			vfront-porch = <2>;
			vback-porch = <10>;
			vsync-len = <2>;
		};
	};
```
