## Documentation/devicetree/bindings/mailbox/brcm,iproc-fs5rm-mbox.yaml
```yaml
# SPDX-License-Identifier: GPL-2.0-only OR BSD-2-Clause
# Copyright 2020 Broadcom
%YAML 1.2
---
$id: http://devicetree.org/schemas/mailbox/brcm,iproc-fs5rm-mbox.yaml#
$schema: http://devicetree.org/meta-schemas/core.yaml#

title: Mailbox controller for Broadcom FS5 ring manager

maintainers:
  - Vikas Gupta <vikas.gupta@broadcom.com>

description:
  The Broadcom FS5 ring manager supports up to 32 channels.
  Each channel or a queue-pair can be used to submit work to offload engines.
  Each device tree entry for FS5-RM represent a group of channels/queue-pairs
  and FS5-RM driver will create a mailbox-controller instance for given entry.

properties:
  compatible:
  const: brcm,iproc-fs5rm-mbox

  reg:
    maxItems: 1

  iommus:
    maxItems: 1

  "#mbox-cells":
    const: 1
    description: first cell is the channel number (0-31)

  msi-parent: true

  dma-coherent: true

required:
  - compatible
  - reg
  - iommus

additionalProperties: false

examples:
  - |

    crypto_mbox2: mbox@180000 {
           compatible = "brcm,iproc-fs5rm-mbox";
           reg = <0x180000 0x80000>;
           msi-parent = <&gic_its8 0xf0022>;
           #mbox-cells = <1>;
           iommus = <&smmu 0xf0002>,
                    <&smmu 0xf0022>;
           dma-coherent;
   };
```

## Documentation/devicetree/bindings/mailbox/brcm,iproc-mailbox-v2.yaml
```yaml
# SPDX-License-Identifier: GPL-2.0
# Copyright 2020 Broadcom
%YAML 1.2
---
$id: http://devicetree.org/schemas/mailbox/brcm,iproc-mailbox-v2.yaml#
$schema: http://devicetree.org/meta-schemas/core.yaml#

title: Broadcom iProc Mailbox Controller V2

maintainers:
  - Shivaraj Shetty <shivaraj.shetty@broadcom.com>

description:
  The iProc mailbox v2, has independent set of doorbell status
  in shared memory which will allow sharing the mailbox register
  with multiple remote processors. The status is set for the
  doorbell which needs to be rung and then mailbox register is
  written to gerenrate the interrupt. On receiving the mailbox
  interrupt driver will go through all doorbell status to see
  which doorbell has been rung.

properties:
  compatible:
    enum:
      - brcm,iproc-mailbox-v2

  reg:
    description:
      Address range for mailbox doorbell status in shared memory.
    maxItems: 1

  interrupts:
    maxItems: 1

  brcm,iproc-mbox:
    allOf:
      - $ref: '/schemas/types.yaml#/definitions/phandle-array'
    description: CRMU DMU with mailbox controller registers.
      - Phandle of syscon block
      - RX register offset within CRMU DMU
      - TX register offset within CRMU DMU

  brcm,iproc-mbox-db-count:
    $ref: '/schemas/types.yaml#/definitions/uint32'
    description: Number of doorbells supported by the mailbox.

  "#mbox-cells":
    const: 2
    description:
      Apart from phandle, the two cells would be doorbell number and doorbell
      type. Dorbell type 0 means tx doorbell and 1 means rx doorbell.

required:
  - compatible
  - reg
  - interrupts
  - brcm,iproc-mbox
  - brcm,iproc-mbox-db-count
  - "#mbox-cells"

examples:
  - |
    #include <dt-bindings/interrupt-controller/arm-gic.h>
    #include <dt-bindings/interrupt-controller/irq.h>
    mbox_crmu: mbox {
        compatible = "brcm,iproc-mailbox-v2";
        reg = <0x40000 0x200>;
        interrupts = <GIC_SPI 389 IRQ_TYPE_LEVEL_HIGH>;
        brcm,iproc-mbox = <&crmu_dmu 0x20 0x00>;
        brcm,iproc-mbox-db-count = <8>;
        #mbox-cells = <2>;
    };
    mailbox_test {
        compatible = "mailbox-test";
        mboxes = <&mbox_crmu 7 0>, <&mbox_crmu 15 1>;
        mbox-names = "tx", "rx";
    };
```

## Documentation/devicetree/bindings/mailbox/brcm,pdc-mbox.txt
```
The PDC driver manages DMA to and from SPU cryptographic acceleration hardware
on some Broadcom SoCs. An SoC may have multiple PDC hardware blocks. There is
one device tree entry per block.

Required properties:
- compatible : Should be "brcm,pdc-mbox".
- reg: Should contain PDC registers location and length.
- interrupts: Should contain the IRQ line for the PDC.
- #mbox-cells: 1
- brcm,rx_status_len: Length of metadata preceding received frames, in bytes.

Optional properties:
- brcm,use_bcm_hdr:  present if a BCM header precedes each frame.
- dma-coherent: Present if dma operations are coherent

Example:
	pdc0: iproc-pdc0@0x612C0000 {
		compatible = "brcm,pdc-mbox";
		reg = <0 0x612C0000 0 0x445>;  /* PDC FS0 regs */
		interrupts = <GIC_SPI 187 IRQ_TYPE_LEVEL_HIGH>;
		#mbox-cells = <1>;   /* one cell per mailbox channel */
		dma-coherent;
		brcm,rx_status_len = <32>;
		brcm,use_bcm_hdr;
	};
```

## Documentation/devicetree/bindings/mailbox/brcm,vk-mailbox.txt
```
* Broadcom Valkyrie SoC Mailbox Controller

Required properties:
- compatible: Must be "brcm,vk-mailbox"
- reg: defines base address of mailbox device registers
- interrupts: mailbox interrupt numbers for instances 0 and 1.
- interrupt-names: interrupt names for mailbox instances 0 and 1.
- #mbox-cells: Must be 1.

Example:

	mailbox: mailbox@40070000 {
		compatible = "brcm,vk-mailbox";
		reg = <0x40070000 0x1000>,
		interrupt-names = "vk_mailbox0", "vk_mailbox1";
		interrupts = <GIC_SPI 9 IRQ_TYPE_LEVEL_HIGH>,
			     <GIC_SPI 8 IRQ_TYPE_LEVEL_HIGH>;
		#mbox-cells = <1>;
	};
```

## Documentation/devicetree/bindings/media/brcm,unicamcpi.txt
```
Broadcom Unicam CPI (Camera Parallel Interface) driver
------------------------------------------------------
Overview
CPI is the camera interface HW IP present in Cygnuc SoC.
This is derived from Unicam IP groups. CPI interface as the name
suggest support only parallel interface. It receives data from the
Parallel interface Image sensor and dumps it to memory. It works on
HSYNC and VSYNC received from Image sensor and generates, Frame Start
And Frame End Interrupts. CPI Drivers state machine works based on
these interrupts. This Driver acts as the "soc-camera" host camera driver in
soc-camera subsystem methodology.

This controller is used in the following Broadom SoC's:
Cygnus

Required properties:
- compatible			: "brcm,unicamcpi"
- id				: Camera ID
- reg				: Physical base address and length of the
				  registers set for the device
- brcm,asiu-padctrl		: Handler of syscon node defining physical base
				  address of the ASIU_TOP_PAD_CTRL
- interrupts			: IRQ line for the CPI
- brcm,unicam-data-width	: Data width in bits
- clocks			: Source for reference clock generation
				  Clock ungate from ASIU
- clock-names			: Reference clock name. Must be "cam-clock"
				  ASIU clock ungate. Must be "cam-gate-clk".
- clock-frequency  		: Reference clock frequency

Unicam CPI supports a single port node with parallel bus. It can contain one
'port' child node with child 'endpoint' node. Please refer to the bindings
defined in Documentation/devicetree/bindings/media/video-interfaces.txt.

Example:
	asiu_padctrl: syscon@180aa05c {
		compatible = "brcm,asiu-padctrl", "syscon";
		reg = <0x180aa05c 0xc>;
	};

	unicam: camera@180a1000 {
		compatible = "brcm,unicamcpi";
		id = <0>;
		reg = <0x180a1000 0x5ff>;
		brcm,asiu-padctrl = <&asiu_padctrl>;
		interrupts = <GIC_SPI 145 IRQ_TYPE_LEVEL_HIGH>;
		brcm,unicam-data-width = <8>;
		clocks = <&audiopll BCM_CYGNUS_AUDIOPLL_CH2>,
			<&asiu_clks BCM_CYGNUS_ASIU_CAM_CLK>;
		clock-names = "cam-clock","cam-gate-clk";
		clock-frequency = <24576000>;
		port {
                        #address-cells = <1>;
                        #size-cells = <0>;

			unicam_0: endpoint {
				remote-endpoint = <&ov5640_0>;
				bus-width = <8>;
			};
                };
	};
```

## Documentation/devicetree/bindings/media/ovti,ov5640.txt
```
Omnivision OV5640 Digital Image Sensor
--------------------------------------
The Omnivision OV5640 is a 1/4-Inch CMOS active pixel digital image sensor
with an active array size of 2592H x 1944V. It supports both parallel and
serial data interface.In Cygnus,we use parallel data interface.

Required Properties:
- compatible	: value should be "ovti,ov5640"
- reg		: address on the i2c bus.

The device node must contain one 'port' child node for its digital output
video port, in accordance with the video interface bindings defined in
Documentation/devicetree/bindings/media/video-interfaces.txt.

Example:

	i2c0: i2c@18008000 {
		...

		ov5640: camera@3c {
			compatible = "ovti,ov5640";
			reg = <0x3c>;

			port {
				ov5640_0: endpoint {
					remote-endpoint = <&unicam_0>;
					bus-width = <8>;
				};
			};
		};
	};
```

## Documentation/devicetree/bindings/mfd/brcm,iproc-d1w.txt
```
* Broadcom Dallas One wire (D1W) bus master controller

Required properties:
- compatible : should be "brcm,iproc-d1w"
- reg : Address and length of the register set for the device
- interrupts : IRQ number of D1W controller

Optional properties:
- clocks : phandle of clock that supplies the module (required if platform
		clock bindings use device tree)
- clock-names : name for the clock
- clock-frequency : D1W divisor clock rate
- reset-recover-delay : Delay while reset D1W in milliseconds.

Example:

- From bcm-cygnus.dtsi:
iproc_d1w: d1w@180ab000 {
	compatible = "brcm,iproc_d1w";
	reg = <0x180ab000 0x0f>;
	interrupts = <GIC_SPI 150 IRQ_TYPE_LEVEL_HIGH>;
	clocks = <&axi81_clk>;
	clock-names = "iproc_d1w_clk";
	clock-frequency = <100000000>;
	reset-recover-delay = <1>;
};
```
