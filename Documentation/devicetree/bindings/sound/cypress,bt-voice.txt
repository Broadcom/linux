## Documentation/devicetree/bindings/sound/cypress,bt-voice.txt
```
Cypress Bluetooth voice audio codec driver

This driver does not actual interface with a Bluetooth device it just
creates an ASoC dai that is used to model the properties for the
voice interface on Cypress Bluetooth chips.

Required properties:
- compatible : "cypress,bt_voice_codec"
-cypress,bt-voice-link-mode : "i2s" or "tdm"

  If "tdm" is specificed
  - cypress,bt-voice-tdm-kbps : bit per second on the link. The BT chip expects
                            a constants bps regardless for frame rate.
			    For example, 2048 kbps would have 256 bpf at 8kHz
			    but 128 bpf at 16 kHz.

Example:

bt_voice_codec {
	compatible = "cypress,bt_voice_codec";

	cypress,bt-voice-link-mode = "i2s";
};

Example using TDM:

bt_voice_codec {
	compatible = "cypress,bt_voice_codec";

	cypress,bt-voice-link-mode = "tdm";
	cypress,bt-voice-tdm-kbps = <2048>;
};
```

## Documentation/devicetree/bindings/spi/brcm,spi-bcm-qspi.txt
```
Broadcom SPI controller

The Broadcom SPI controller is a SPI master found on various SOCs, including
BRCMSTB (BCM7XXX), Cygnus, NSP and NS2. The Broadcom Master SPI hw IP consits
of :
 MSPI : SPI master controller can read and write to a SPI slave device
 BSPI : Broadcom SPI in combination with the MSPI hw IP provides acceleration
        for flash reads and be configured to do single, double, quad lane
        io with 3-byte and 4-byte addressing support.

 Supported Broadcom SoCs have one instance of MSPI+BSPI controller IP.
 MSPI master can be used wihout BSPI. BRCMSTB SoCs have an additional instance
 of a MSPI master without the BSPI to use with non flash slave devices that
 use SPI protocol.

Required properties:

- #address-cells:
    Must be <1>, as required by generic SPI binding.

- #size-cells:
    Must be <0>, also as required by generic SPI binding.

- compatible:
    Must be one of :
    "brcm,spi-bcm-qspi", "brcm,spi-brcmstb-qspi" : MSPI+BSPI on BRCMSTB SoCs
    "brcm,spi-bcm-qspi", "brcm,spi-brcmstb-mspi" : Second Instance of MSPI
						   BRCMSTB  SoCs

- reg:
    Define the bases and ranges of the associated I/O address spaces.
    The required range is MSPI controller registers.

- reg-names:
    First name does not matter, but must be reserved for the MSPI controller
    register range as mentioned in 'reg' above, and will typically contain
    - "bspi_regs": BSPI register range, not required with compatible
                   "spi-brcmstb-mspi"
    - "mspi_regs": MSPI register range is required for compatible strings

- interrupts
    The interrupts used by the MSPI and/or BSPI controller.

- interrupt-names:
    Names of interrupts associated with MSPI
    - "mspi_halted" :
    - "mspi_done": Indicates that the requested SPI operation is complete.
    - "spi_lr_fullness_reached" : Linear read BSPI pipe full
    - "spi_lr_session_aborted"  : Linear read BSPI pipe aborted
    - "spi_lr_impatient" : Linear read BSPI requested when pipe empty
    - "spi_lr_session_done" : Linear read BSPI session done

- clocks:
    A phandle to the reference clock for this block.

Optional properties:


- native-endian
    Defined when using BE SoC and device uses BE register read/write

Recommended optional m25p80 properties:
- spi-rx-bus-width: Definition as per
                    Documentation/devicetree/bindings/spi/spi-bus.txt

Examples:

BRCMSTB SoC Example:

  SPI Master (MSPI+BSPI) for SPI-NOR access:

    spi@f03e3400 {
		#address-cells = <0x1>;
		#size-cells = <0x0>;
		compatible = "brcm,spi-brcmstb-qspi", "brcm,spi-brcmstb-qspi";
		reg = <0xf03e0920 0x4 0xf03e3400 0x188 0xf03e3200 0x50>;
		reg-names = "cs_reg", "mspi", "bspi";
		interrupts = <0x6 0x5 0x4 0x3 0x2 0x1 0x0>;
		interrupt-parent = <0x1c>;
		interrupt-names = "mspi_halted",
				  "mspi_done",
				  "spi_lr_overread",
				  "spi_lr_session_done",
				  "spi_lr_impatient",
				  "spi_lr_session_aborted",
				  "spi_lr_fullness_reached";

		clocks = <&hif_spi>;
		clock-names = "sw_spi";

		m25p80@0 {
			#size-cells = <0x2>;
			#address-cells = <0x2>;
			compatible = "m25p80";
			reg = <0x0>;
			spi-max-frequency = <0x2625a00>;
			spi-cpol;
			spi-cpha;
			m25p,fast-read;

			flash0.bolt@0 {
				reg = <0x0 0x0 0x0 0x100000>;
			};

			flash0.macadr@100000 {
				reg = <0x0 0x100000 0x0 0x10000>;
			};

			flash0.nvram@110000 {
				reg = <0x0 0x110000 0x0 0x10000>;
			};

			flash0.kernel@120000 {
				reg = <0x0 0x120000 0x0 0x400000>;
			};

			flash0.devtree@520000 {
				reg = <0x0 0x520000 0x0 0x10000>;
			};

			flash0.splash@530000 {
				reg = <0x0 0x530000 0x0 0x80000>;
			};

			flash0@0 {
				reg = <0x0 0x0 0x0 0x4000000>;
			};
		};
	};


    MSPI master for any SPI device :

	spi@f0416000 {
		#address-cells = <1>;
		#size-cells = <0>;
		clocks = <&upg_fixed>;
		compatible = "brcm,spi-brcmstb-qspi", "brcm,spi-brcmstb-mspi";
		reg = <0xf0416000 0x180>;
		reg-names = "mspi";
		interrupts = <0x14>;
		interrupt-parent = <&irq0_aon_intc>;
		interrupt-names = "mspi_done";
	};
```

## Documentation/devicetree/bindings/spi/brcm,spidev.txt
```
Broadcom MSR SPI slave

Required properties:
- compatible: Should be "brcm,msr".

Example:

&spi1 {
	status = "okay";
	num-cs = <1>;
	spidev@0 {
		compatible = "brcm,msr";
		reg = <0>;
		spi-max-frequency = <5000000>;
	};
};
```

## Documentation/devicetree/bindings/spi/spidev-test.txt
```
SPIDEV Testing Device

Required properties:
- compatible: should be "spidev-test"
- reg: chipselect number to be used for testing

Example:

ssp0: ssp@68a80000 {
	compatible = "arm,pl022", "arm,primecell";
	reg = <0x68a80000 0x1000>;
	interrupts = <GIC_SPI 187 IRQ_TYPE_LEVEL_HIGH>;
	clocks = <&hsls_div4_clk>, <&hsls_div4_clk>;
	clock-names = "spiclk", "apb_pclk";
	#address-cells = <1>;
	#size-cells = <0>;

	spidev@0 {
		compatible = "spidev-test";
		spi-max-frequency = <8000000>;
		reg = <0>;
	};
};
```

## Documentation/devicetree/bindings/staging/brcmesw/brcm,esw-ctl.txt
```
* Broadcom Ethernet Switch Interface

Required properties:
- compatible:	Should be "brcm,esw-ctl"
- reg:		Physical base address and length of the switch registers

Example:

esw_ctl: esw_ctl@28242000 {
	compatible = "brcm,esw-ctl";
	reg = <0x28242000 0x50>;
};
```

## Documentation/devicetree/bindings/thermal/brcm,sr-thermal.txt
```
* Broadcom Stingray Thermal

This binding describes thermal sensors that is part of Stingray SoCs.

Required properties:
- compatible : Must be "brcm,sr-thermal"
- reg : memory where tmon data will be available.

Example:
	tmons {
		compatible = "simple-bus";
		#address-cells = <1>;
		#size-cells = <1>;
		ranges;

		tmon_ihost0: thermal@8f100000 {
			compatible = "brcm,sr-thermal";
			reg = <0x8f100000 0x4>;
		};

		tmon_ihost1: thermal@8f100004 {
			compatible = "brcm,sr-thermal";
			reg = <0x8f100004 0x4>;
		};

		tmon_ihost2: thermal@8f100008 {
			compatible = "brcm,sr-thermal";
			reg = <0x8f100008 0x4>;
		};

		tmon_ihost3: thermal@8f10000c {
			compatible = "brcm,sr-thermal";
			reg = <0x8f10000c 0x4>;
		};

		tmon_crmu: thermal@8f100010 {
			compatible = "brcm,sr-thermal";
			reg = <0x8f100010 0x4>;
		};

		tmon_nitro: thermal@8f100014 {
			compatible = "brcm,sr-thermal";
			reg = <0x8f100014 0x4>;
		};
	};
```

## Documentation/devicetree/bindings/timer/brcm,cygnus-crmu-timer.txt
```
Broadcom Cygnus CRMU Timer

The always on Cortex-M0 MCU processor provides a timer that can be read using
the mailbox controller. It is used on Cygnus as a persistent clock across power
management state transitions.

Required properties:

- compatible: Must be "brcm,cygnus-crmu-timer"
- mboxes: A phandle specifying the mailbox controller and channel used to
  communicate with the M0 processor.

Example:

	cygnus_crmu_timer: cygnus_crmu_timer {
		compatible = "brcm,cygnus-crmu-timer";
		mboxes = <&mailbox 4>;
	};
```

## Documentation/devicetree/bindings/usb/brcm,bdc-usb3.txt
```
Broadcom USB device controller

Required properties:
  - compatible: "brcm,bdc-usb3"
  - reg: Base address and length of the BDC register
  - interrupts: Interrupt line of BDC

Optional properties:
  - phys: list of phandles to PHY nodes.
  - phy-names: list of phy phandle names.
	phy-names has to be "bdc-phy".

Example:
	bdc0: usb@68521000{
			compatible = "brcm,bdc-usb3";
			reg = <0x68521000 0x1000>;
			interrupts = <GIC_SPI 266 IRQ_TYPE_LEVEL_HIGH>;
			phys = <&usb1_phy1 1>;
			phy-names = "bdc-phy";
		};
```

## Documentation/devicetree/bindings/vfio/brcm,iproc-nva.yaml
```yaml
# SPDX-License-Identifier: GPL-2.0-only OR BSD-2-Clause
# Copyright 2021 Broadcom
%YAML 1.2
---
$id: http://devicetree.org/schemas/soc/bcm/brcm,iproc-nva.yaml#
$schema: http://devicetree.org/meta-schemas/core.yaml#

title: NVMe processing accelerator for Broadcom SoCs emulating NVMe controller.

maintainers:
  - Guru Prasad <guru.prasad@broadcom.com>

description:
  The Broadcom NVA unit provide hardware acceleration for emulated NVMe
  controllers on Broadcom Smartnic SoCs. It supports Single Root I/O
  Virtualization, implements a per-VC (virtual controller) NVMe controller
  registers and offloads NVMe queue management and scheduling functions for
  NVMe admin/IO queues.

properties:
  compatible:
  const: brcm,iproc-nva

  reg:
    maxItems: 1

  iommus:
    maxItems: 1

  msi-parent: true

  dma-coherent: true

required:
  - compatible
  - reg
  - iommus

additionalProperties: false

examples:
  -

    nva: nva@0 {
        compatible = "brcm,iproc-nva";
        reg = <0x00000000 0x1000000>;
        msi-parent = <&gic_its9 0xfc000>;
        dma-coherent;
        iommus = <&smmu 0xfc000>;
    };
```

## Documentation/devicetree/bindings/virtio/brcm,iproc-vee.yaml
```yaml
# SPDX-License-Identifier: GPL-2.0-only OR BSD-2-Clause
# Copyright 2021 Broadcom
%YAML 1.2
---
$id: http://devicetree.org/schemas/net/brcm,iproc-vee.yaml#
$schema: http://devicetree.org/meta-schemas/core.yaml#

title: VirtIO HW emulation engine for Broadcom's iProc based SoCs.

maintainers:
  - Manish Kurup <manish.kurup@broadcom.com>

description:
  The Broadcom VEE device is the VirtIO Emulation Engine and is part of the
  NVME subsystem on the SoC.
  It provides VirtIO net/block services to PCIe and to processing elements on
  the SoC. It contains 32 PFs, 2048 VFs, 1024 Rx queues and 2048 Tx queues. The
  Tx and Rx queues are shared among the net and block functions.

properties:
  compatible:
  const: brcm,iproc-vee

  reg:
    maxItems: 1

  iommus:
    maxItems: 1

  msi-parent: true

  dma-coherent: true

required:
  - compatible
  - reg

additionalProperties: false

examples:
  -

    vee: vee@8000000 {
        compatible = "brcm,iproc-vee";
        reg = <0x8000000 0xc0000>;
        msi-parent = <&gic_its6 0xfc010>;
        dma-coherent;
        iommus = <&smmu 0xfc010>;
    };
```
