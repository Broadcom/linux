## Documentation/devicetree/bindings/pinctrl/brcm,iproc-gpio.txt
```
Broadcom iProc GPIO/PINCONF Controller

Required properties:

- compatible:
    "brcm,iproc-gpio" for the generic iProc based GPIO controller IP that
    supports full-featured pinctrl and GPIO functions used in various iProc
    based SoCs

    May contain an SoC-specific compatibility string to accommodate any
    SoC-specific features

    "brcm,cygnus-ccm-gpio", "brcm,cygnus-asiu-gpio", or
    "brcm,cygnus-crmu-gpio" for Cygnus SoCs

    "brcm,iproc-nsp-gpio" for the iProc NSP SoC that has drive strength support
    disabled

    "brcm,iproc-stingray-gpio" for the iProc Stingray SoC that has the general
    pinctrl support completely disabled in this IP block. In Stingray, a
    different IP block is used to handle pinctrl related functions

- reg:
  - Register set that define the base and range of the I/O address space that
contains SoC GPIO/PINCONF controller registers. Always present
  - Additional PINCONF registers. Present only for "brcm,cygnus-ccm-gpio",
"brcm,cygnus-crmu-gpio"

- ngpios:
    Total number of in-use slots in GPIO controller

- #gpio-cells:
    Must be two. The first cell is the GPIO pin number (within the
controller's pin space) and the second cell is used for the following:
    bit[0]: polarity (0 for active high and 1 for active low)

- gpio-controller:
    Specifies that the node is a GPIO controller

Optional properties:

- interrupts:
    Interrupt ID

- interrupt-controller:
    Specifies that the node is an interrupt controller

- interrupt-parent:
    Specifies an interrupt parent. The parent can be the mailbox controller if
    interrupt forwarding is being used. If this is the case then 'interrupts'
    must be 0 to specify the AON GPIO irq domain.

- #interrupt-cells:
    Must be two. The first cell is the GPIO pin number (within the controller's
    pin space) and the second cell is used to specify flags. See also
    Documentation/devicetree/bindings/interrupt-controller/interrupts.txt
    for more details.

- gpio-ranges:
    Specifies the mapping between gpio controller and pin-controllers pins.
    This requires 4 fields in cells defined as -
    1. Phandle of pin-controller.
    2. GPIO base pin offset.
    3  Pin-control base pin offset.
    4. number of gpio pins which are linearly mapped from pin base.

- brcm,pinconf-func-off:
    Certain iProc SoCs might have some of the PINCONF functions disabled in
the chip when the iProc GPIO controller is integrated. This optional property
allows unsupported PINCONF functions to be disabled

- mboxes:
    A phandle specifying the mailbox controller and channel used to communicate
    with the co-processor. This is required to configure a gpio pin as a wake
    source from sleep and deep sleep states.

Supported generic PINCONF properties in child nodes:

- pins:
    The list of pins (within the controller's own pin space) that properties
in the node apply to. Pin names are "gpio-<pin>"

- bias-disable:
    Disable pin bias

- bias-pull-up:
    Enable internal pull up resistor

- bias-pull-down:
    Enable internal pull down resistor

- drive-strength:
    Valid drive strength values include 2, 4, 6, 8, 10, 12, 14, 16 (mA)

- input-schmitt-enable:
    Enable schmitt-trigger mode

- input-schmitt-disable:
    Disable schmitt-trigger mode

Example:
	/*
	 * Mailbox controller used by gpio_crmu. For more information see:
	 * Documentation/devicetree/bindings/mailbox/brcm,iproc-mailbox.txt
	 */
	mailbox: mailbox@03024024 {
		compatible = "brcm,iproc-mailbox";
		reg = <0x03024024 0x40>;
		interrupts = <GIC_SPI 138 IRQ_TYPE_LEVEL_HIGH>;
		#interrupt-cells = <1>;
		interrupt-controller;
		#mbox-cells = <1>;
	};

	/*
	 * CRMU gpio handler configured with mailbox channel 1 to
	 * support wake source configuration.
	 */
	gpio_crmu: gpio@03024800 {
		compatible = "brcm,cygnus-crmu-gpio";
		reg = <0x03024800 0x50>,
		      <0x03024008 0x18>;
		ngpios = <6>;
		#gpio-cells = <2>;
		gpio-controller;
		interrupt-controller;
		interrupt-parent = <&mailbox>;
		interrupts = <0>;
		mboxes = <&mailbox 1>;
	};

	gpio_ccm: gpio@1800a000 {
		compatible = "brcm,cygnus-ccm-gpio";
		reg = <0x1800a000 0x50>,
		      <0x0301d164 0x20>;
		ngpios = <24>;
		#gpio-cells = <2>;
		gpio-controller;
		interrupts = <GIC_SPI 84 IRQ_TYPE_LEVEL_HIGH>;
		interrupt-controller;

		touch_pins: touch_pins {
			pwr: pwr {
				pins = "gpio-0";
				drive-strength = <16>;
			};

			event: event {
				pins = "gpio-1";
				bias-pull-up;
			};
		};
	};

	gpio_asiu: gpio@180a5000 {
		compatible = "brcm,cygnus-asiu-gpio";
		reg = <0x180a5000 0x668>;
		ngpios = <146>;
		#gpio-cells = <2>;
		gpio-controller;
		interrupts = <GIC_SPI 174 IRQ_TYPE_LEVEL_HIGH>;
		interrupt-controller;
		gpio-ranges = <&pinctrl 0 42 1>,
				<&pinctrl 1 44 3>;
	};

	/*
	 * Touchscreen that uses the CCM GPIO 0 and 1
	 */
	tsc {
		...
		...
		gpio-pwr = <&gpio_ccm 0 0>;
		gpio-event = <&gpio_ccm 1 0>;
	};

	/* Bluetooth that uses the ASIU GPIO 5, with polarity inverted */
	bluetooth {
		...
		...
		bcm,rfkill-bank-sel = <&gpio_asiu 5 1>
	}
```

## Documentation/devicetree/bindings/pinctrl/brcm,omega-pinctrl.txt
```
Broadcom Omega GPIO/PINCONF Controller

Required properties:

- compatible:
    "brcm,omega-pinctrl" for the Omega based GPIO/pinconf controller IP

- reg:
    Define the base and range of the I/O address space that contains SoC
    GPIO/PINCONF controller registers

- ngpios:
    Total number of in-use slots in GPIO/PINCONF controller

- #gpio-cells:
    Must be two. The first cell is the GPIO pin number (within the controller's
    pin space) and the second cell is used for the following:
    bit[0]: polarity (0 for active high and 1 for active low)

- gpio-controller:
    Specifies that the node is a GPIO controller

- interrupts:
    Interrupt ID

- interrupt-controller:
    Specifies that the node is an interrupt controller

- gpio-ranges:
    Specifies the mapping between pinmux controller and gpio pins.
    This requires 4 fields in cells defined as -
    1. Phandle of pinmux controller.
    2. GPIO base pin offset.
    3  Pin-control base pin offset.
    4. number of gpio pins which are linearly mapped from pin base.

The following generic properties as defined in pinctrl-bindings.txt are valid
to specify in a pin configuration subnode:

  pins, bias-disable, bias-pull-down, bias-pull,up, drive-strength,
  input-enable, input-disable, input-schmitt-enable, input-schmitt-disable,
  slew-rate.

The pins on Omega PINCONF controller are divided into two sections: west section
contains mfio pins 0-50; east section contains mfio pins 51-112.

Example:
	gpio_west: pinctrl@285a0000 {
		compatible = "brcm, omega-pinctrl";
		reg = <0x285a0000 0x330>;
		ngpios = <51>;
		#gpio-cells = <2>;
		gpio-controller;
		interrupt-controller;
		interrupts = <GIC_SPI 52 IRQ_TYPE_LEVEL_HIGH>;
		gpio-ranges = <&pinmux0 0 0 51>;
		key_pins: key_pins {
			pins = "mfio-21", "mfio-22", "mfio-23", "mfio-24";
			drive-strength = <16>;
			slew-rate = <1>;
		};
	};


	gpio_east: gpio@003d0000 {
		compatible = "brcm, omega-pinctrl";
		reg = <0x003d0000 0x3e0>;
		ngpio = <62>;
		#gpio-cells = <2>;
		gpio-controller;
		interrupt-controller;
		interrupts = <GIC_SPI 51 IRQ_TYPE_LEVEL_HIGH>;
		gpio-ranges = <&pinmux1 51 51 62>;
	};
```

## Documentation/devicetree/bindings/power/reset/brcm,iproc-reset.txt
```
Device tree binding for broadcom iproc reset functionality.

The system reset is implemented in the M0 processor.
A message is sent to M0 via the mailbox driver which would
contain a command to reset. This command when received at M0
triggers the reset sequence.

Required properties:
- compatible: should be "brcm,iproc-reset".
- mboxes: list of phandle and mailbox channel specifier,
used for communication with a power management co-processor.

Examples:

		iproc-reset {
			compatible = "brcm,iproc-reset";
			mboxes = <&mailbox 0>;
		};
```

## Documentation/devicetree/bindings/power/supply/brcm,swreg.txt
```
Broadcom SWREG Device Tree Bindings
-------------------------------------------------------------

Required properties:
	- compatible: Should contain the SWREG compatibility string
		      and the SoC compatibility string.
		      "brcm,swreg"
	- reg       : Physical base address and size of the
		      SWREG registers

Examples:
	swreg: swreg@6641c028 {
		compatible = "brcm,swreg";
		reg = <0x6641c028 0x8>;
		status = "disabled";
	};
```

## Documentation/devicetree/bindings/ptp/brcm,ptp-iproc-dte.txt
```
* Broadcom iProc Digital Timing Engine(DTE) based PTP clock driver

Required properties:
- compatible: should be "brcm,ptp-iproc-dte"
- reg: address and length of the DTE block's NCO registers

Example:

ptp_dte: ptp_dte@180af650 {
	compatible = "brcm,ptp-iproc-dte";
	reg = <0x180af650 0x10>;
	status = "okay";
};
```

## Documentation/devicetree/bindings/pwm/brcm,omega-pwm.txt
```
Broadcom Omega PWM controller device tree bindings

This controller has 4 channels.

Required Properties :
- compatible: must be "brcm,omega-pwm"
- reg: physical base address and length of the controller's registers
- clocks: phandle + clock specifier pair for the external clock
- #pwm-cells: Should be 3. See pwm.txt in this directory for a
  description of the cells format.

Refer to clocks/clock-bindings.txt for generic clock consumer properties.

Example:

pwm: pwm@28580000 {
	compatible = "brcm,omega-pwm";
	reg = <0x28580000 0xc90>;
	clocks = <&clk_periph_apb>;
	#pwm-cells = <3>;
};
```

## Documentation/devicetree/bindings/rtc/brcm,iproc-rtc.txt
```
Broadcom RTC driver used for accessing RTC via smc calls

Required properties:
- compatible: "brcm,iproc-rtc"
- interrupts: interrupt number for periodic interrupt

Optional properties:
- interrupts: interrupt number for alarm interrupt

Example:
rtc: rtc {
	compatible = "brcm,iproc-rtc";
	interrupts = <GIC_SPI 20 IRQ_TYPE_EDGE_RISING>,
		     <GIC_SPI 21 IRQ_TYPE_EDGE_RISING>;
};
```

## Documentation/devicetree/bindings/serial/brcm,bcm-bptty-console.txt
```
* Broadcom TTY Console over PCIe memory

Required properties:

- compatible: "brcm,bcm-bptty-console"

- xmit-addr: Memory offset to write output

- recv-addr: Memory offset to read input

Example:

	uart1: serial@0 {
		compatible = "brcm,bcm-bptty-console";
		xmit-addr = <0x5 0xBFF00000>;
		recv-addr = <0x5 0xBFE00000>;
	};
```

## Documentation/devicetree/bindings/serial/brcm,bptty-console.txt
```
* Broadcom TTY Console over PCIe memory

Required properties:

- compatible: "brcm,bptty-console"

- brcm-xmit-addr: memory offset to write output

- brcm-recv-addr: memory offset to read input

Optional properties:

- reg: offset and length of the register set for the doorbell

- interrupts: doorbell interrupt, if not provided will fall back to polling

- brcm-msix-source: phandle to PCIe endpoint node to generate msix interrupt
 to host on tty write, which must define "brcm-ep-name" property

Example:

	uart1: serial@40070000 {
		reg = <0x0 0x40070000 0x1000>;
		compatible = "brcm,bptty-console";
		brcm-xmit-addr = <0x5 0xbff00000>;
		brcm-recv-addr = <0x5 0xbfe00000>;
		interrupts = <GIC_SPI 8 IRQ_TYPE_LEVEL_HIGH>;
		brcm-msix-source = <&pcie_ep>;
	};
```

## Documentation/devicetree/bindings/soc/bcm/brcm,iproc-idm.txt
```
Broadcom iProc Interconnect Device Management (IDM) device

The Broadcom iProc IDM device allows control and monitoring of ASIC internal
bus transactions. Most importantly, it can be configured to detect bus
transaction timeout. In such case, critical information such as transaction
address that caused the error, bus master ID of the transaction that caused
the error, and etc., are made available from the IDM device.

-------------------------------------------------------------------------------

Required properties for IDM device node:
- compatible: must be "brcm,iproc-idm", followed by an IDM device specific
  compatible string (see below for more details)
- reg: base address and length of the IDM register space
- interrupt: IDM interrupt number

Optional properties for IDM device node:
- brcm,iproc-idm-elog: phandle to the device node of the IDM logging device

-------------------------------------------------------------------------------

Required properties for IDM error logging device node:
- compatible: must be "brcm,iproc-idm-elog";
- reg: base address and length of reserved memory location where IDM error
  events can be saved

-------------------------------------------------------------------------------

Example:

iproc-idm {
	idm-elog {
		compatible = "brcm,iproc-idm-elog";
		reg = <0x8f221000 0x1000>;
	};

	idm-mhb-paxc-axi {
		compatible = "brcm,iproc-idm", "brcm,sr-idm-mhb-paxc-axi;
		interrupt = <GIC_SPI 516 IRQ_TYPE_LEVEL_HIGH>;
		brcm,iproc-idm-elog = <&idm-elog>;
	};
};

List of supported IDM devices for Stingray is:
"brcm,sr-idm-paxb0-axi"
"brcm,sr-idm-paxb1-axi"
"brcm,sr-idm-paxb2-axi"
"brcm,sr-idm-paxb3-axi"
"brcm,sr-idm-pcie-axi"
"brcm,sr-idm-paxb4-axi"
"brcm,sr-idm-paxb5-axi"
"brcm,sr-idm-paxb6-axi"
"brcm,sr-idm-paxb7-axi"
"brcm,sr-idm-mhb-nitro-axi"
"brcm,sr-idm-mhb-pcie-axi"
"brcm,sr-idm-mhb-ep-apb"
"brcm,sr-idm-mhb-paxc-axi"
"brcm,sr-idm-mhb-apb"
"brcm,sr-idm-mhb-paxc-apb"
"brcm,sr-idm-nic-axi2apb"
"brcm,sr-idm-nic-chimp"
"brcm,sr-idm-nic-ds0"
"brcm,sr-idm-scr-pcie0"
"brcm,sr-idm-scr-pcie1"
"brcm,sr-idm-scr-paxc"
"brcm,sr-idm-scr-fs"
"brcm,sr-idm-scr-hsls"
"brcm,sr-idm-scr-crmu"
"brcm,sr-idm-scr-usb"
"brcm,sr-idm-scr-axi2apb-div4"
"brcm,sr-idm-scr-axi2apb-div4-emem"
"brcm,sr-idm-scr-axi2apb-cssys"
"brcm,sr-idm-scr-smmu"
"brcm,sr-idm-scr-gic500"
"brcm,sr-idm-scr-sata"
"brcm,sr-idm-scr-cssys-stm-axi"
"brcm,sr-idm-scr-ds0"
"brcm,sr-idm-fs4-axi2apb-div2"
"brcm,sr-idm-fs4-axi2apb"
"brcm,sr-idm-fs4-sram"
"brcm,sr-idm-fs4-crypto"
"brcm,sr-idm-fs4-raid"
"brcm,sr-idm-sata-apbt0"
"brcm,sr-idm-sata-apbt1"
"brcm,sr-idm-sata-reodrder-bridge"
"brcm,sr-idm-sata-apbs"
"brcm,sr-idm-drdu3"
"brcm,sr-idm-drdu2"
"brcm,sr-idm-usb3h"
"brcm,sr-idm-gbridge"
"brcm,sr-idm-rom-s0"
"brcm,sr-idm-nand"
"brcm,sr-idm-pnor"
"brcm,sr-idm-qspi"
"brcm,sr-idm-apbr"
"brcm,sr-idm-apbspi"
"brcm,sr-idm-apbx"
"brcm,sr-idm-apby"
"brcm,sr-idm-apbz"
"brcm,sr-idm-sdio0-axi2ahb"
"brcm,sr-idm-sdio1-axi2ahb"
```
