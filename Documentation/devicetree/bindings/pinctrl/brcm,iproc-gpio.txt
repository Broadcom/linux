## Documentation/devicetree/bindings/soc/bcm/brcm,omega-scp.txt
```
Broadcom Omega System Control Processor Device Tree Bindings

The Omega System Control Processor(SCP) is responsible for power state
transitions, and system functionality in low power states. For instance, it
- Configure the state of AON regulators during low power modes.
- Configure the state of LED during low power modes.

Required properties:
- compatible: must be "brcm,omega-scp".
- mboxes: A phandle specifying the mailbox controller and channel used to
    communicate with the scp.

Each configuration should be represented by a child node

Mandatory properties for the child node:
- brcm,pm-function: function to be configured for the node. Valid options are
    "regulator" and "led".

Optional properties for the child node:
- brcm,pm-supply: phandle to power management regulator.
- brcm,pm-regulator-off-in-mem-state: regulator should be disabled by scp while
    in suspend-to-ram-state. If this node is missing the regulator state is not
    modified upon entering and exiting suspend-to-ram state.
- brcm,pm-regulator-off-in-off-state: regulator should be disabled by scp while
    in OFF mode. If this node is missing the regulator state is not modified
    upon entering and exiting OFF state.
- brcm,led-gpio: phandle to gpio that controls led.
- brcm,led-onoff: on and off periods in msec during low power state.

Mandatory properties for the regulator node:
- gpio: gpio to use for enable control

Optional properties for the regulator node:
- startup-delay-us: startup time in microseconds
- enable-active-high: Polarity of GPIO is Active high

Example:

	scp: scp {
		compatible = "brcm,omega-scp";
		mboxes = <&mailbox 0>;

		scp0: scp@0 {
			brcm,pm-function = "regulator";
			brcm,pm-supply = <&vdd_reg>;
			brcm,pm-regulator-off-in-mem-state;
			brcm,pm-regulator-off-in-off-state;
		};

		scp1: scp@1 {
			brcm,pm-function = "regulator";
			brcm,pm-supply = <&xyz_reg>;
			brcm,pm-regulator-off-in-mem-state;
		};

		scp2: scp@2 {
			brcm,pm-function = "led";
			brcm,led-gpio = <&gpio_crmu 3 0>;
			brcm,led-onoff = <2 3>;
		};
	};
```

## Documentation/devicetree/bindings/soc/bcm/brcm,omega-topctrl.txt
```
* Boradcom Omega ICFG device tree bindings

Broadcom Omega ICFG driver is used to initialize one-time configuration in
ICFG upon platform bootup.

Required properties:
- compatible: Should be "brcm,omega-top-ctrl".

- brcm,omega-icfg: phandle to the ICFG syscon node

Board Specific Properties:
- brcm,omega-key-row-mux: An optional property to store an array of K indices
			  to assign certain keypad IOs (K0..K13) as rows.
			  There are a total of 14 IOs(Kn) that can support
			  the maximum of 49 buttons (7x7)

- brcm,omega-key-col-mux: An optional property to store an array of K indices
			  to assign certain keypad IOs (K0..K13) as cols.
			  There are a total of 14 IOs(Kn) that can support
			  the maximum of 49 buttons (7x7)

Example:

icfg: syscon@285b0000 {
	compatible = "brcm,omega-icfg", "syscon";
	reg = <0x285b0000 0x600>;
};

top-ctrl {
	compatible = "brcm,omega-top-ctrl";
	brcm,omega-icfg = <&icfg>;
	brcm,omega-key-row-mux = <0x0 0x1 0x2 0x3 0x4>;
	brcm,omega-key-col-mux = <0x5 0x6 0x7 0x8 0x9>;
};
```

## Documentation/devicetree/bindings/sound/ak4385.txt
```
AK4385 Codec

Required properties:
  - compatible : "asahi-kasei,ak4385"
  - reg :  chip select number on the SPI bus
  - power-gpio = gpio used to reset/power down the chip

Optional properties:
  - amp-mute-gpio = gpio used to mute external op amp

Example:

ak4385_codec: ak4385@0 {
	compatible = "asahi-kasei,ak4385";
	reg = <0>;

	power-gpio = <&gpio_asiu 120 0>;
	amp-mute-gpio = <&gpio_asiu 102 0>;
};
```

## Documentation/devicetree/bindings/sound/ak4458.txt
```
AK4458 115dB 768kHz 32-bit 8ch Premium DAC

Required properties:

  - compatible : "asahi-kasei,ak4458"

  - reg : the I2C address of the device

Optional properties:

  - amp-mute-gpio : gpio used to mute external analog amplifier

Example:

ak4458_codec: ak4458@10 {
	compatible = "asahi-kasei,ak4458";
	reg = <0x10>;
	amp-mute-gpio = <&gpio_asiu 43 0>;
};
```

## Documentation/devicetree/bindings/sound/brcm,audioh-codec.txt
```
AudioH - Broadcom integrated codec driver.

Required properties:
- compatible: "brcm,audioh"
- #sound-dai-cells: must be equal to 1
- reg: the register address of the device.
- reg-names: should be "audioh"
- clocks: clock for the audioh codec
- clock-names: should be "codec_clk"
- interrupts: the codec's interrupt
- brcm,audioh-crmu-syscon:  a phandle to the crmu syscon area that contain a
                            few of the codec's regs

Example:
  	omega_codec: audioh@29490000 {
		#sound-dai-cells = <1>;
		compatible = "brcm,audioh";
		reg = <0x29490000 0xc000>;
		reg-names = "audioh";

		brcm,audioh-crmu-syscon = <&crmu_syscon>;
		interrupts = <GIC_SPI 175 IRQ_TYPE_LEVEL_HIGH>;

		clocks = <&codec_clock>;
		clock-names = "codec_clk";

		status = "disabled";
	};
```

## Documentation/devicetree/bindings/sound/brcm,cygnus-911360-entphn.txt
```
Cygnus Enterprise Phone reference design

Required properties:
- compatible: "brcm,bcm911360_entphn-machine"
- brcm,cygnus-pcm: the phandle of the audio DMA node
- brcm,handsfree-amp-en-gpio: gpio used to conrol the enabling of the
	handsfree speaker amplifier.

In addition to these properties, the device follows the general construct
of the multi-dai generic "simple audio card".  Refer to simple-card.txt.

The only valid dai properties for this design are
 - format
 - bitclock-master
 - frame-master


Example:
ipp_sound {
	compatible = "brcm,bcm911360_entphn-machine";
	brcm,cygnus-pcm = <&cygnus_audio>;
	brcm,handsfree-amp-en-gpio = <&gpio_asiu 41 0>;

	ipp-primary-link {
		format = "i2s";
		bitclock-master = <&dailink0_master>;
		frame-master = <&dailink0_master>;

		dailink0_master: cpu {
			sound-dai = <&cygnus_audio 0>;
		};

		codec {
			sound-dai = <&cs42l73 0>;
		};
	} ;

	ipp-bluetooth-voice-link {
		format = "i2s";
		bitclock-master = <&dailink1_master>;
		frame-master = <&dailink1_master>;

		dailink1_master: cpu {
			sound-dai = <&cygnus_audio 2>;
		};

		codec {
			sound-dai = <&bt_codec>;
		};
	};

	status = "okay";
};
```

## Documentation/devicetree/bindings/sound/brcm,cygnus-958305-aud-base.txt
```
Cygnus BCM958305_AUD_BASE ASoC machine driver

Required properties:
- compatible: "brcm,bcm958305-aud-base-machine"
- brcm,cygnus-pcm: the phandle of the audio DMA node

In addition to these properties, the device follows the general construct
of the multi-dai generic "simple audio card".  Refer to simple-card.txt.

The only valid dai properties for this design are
 - format
 - bitclock-master
 - frame-master


Example:
sound {
	compatible = "brcm,bcm958305-aud-base-machine";
	brcm,cygnus-pcm = <&cygnus_audio>;

	link0 {
		format = "i2s";
		bitclock-master = <&dailink0_master>;
		frame-master = <&dailink0_master>;

		dailink0_master: cpu {
			sound-dai = <&cygnus_audio 0>;
		};

		codec {
			sound-dai = <&wm8994_codec 0>; /* wm8994-aif1 */
		};
	} ;

	link1 {
		format = "i2s";
		bitclock-master = <&dailink1_master>;
		frame-master = <&dailink1_master>;

		dailink1_master: cpu {
			sound-dai = <&cygnus_audio 1>;
		};

		codec {
			sound-dai = <&ak4385_codec>;
		};
	};

	link2 {
		format = "i2s";
		bitclock-master = <&dailink2_master>;
		frame-master = <&dailink2_master>;

		dailink2_master: cpu {
			sound-dai = <&cygnus_audio 3>;
		};

		codec {
			sound-dai = <&spdif_dummy_tx>;
		};
	};

	status = "okay";
};
```

## Documentation/devicetree/bindings/sound/brcm,cygnus-audio.txt
```
BROADCOM Cygnus Audio I2S/TDM/SPDIF controller

Required properties:
	- compatible : "brcm,cygnus-audio"
	- #address-cells: 32bit valued, 1 cell.
	- #size-cells:  32bit valued, 0 cell.
	- reg : Should contain audio registers location and length
	- reg-names: names of the registers listed in "reg" property
		Valid names are "aud" and "i2s_in". "aud" contains a
		set of DMA, I2S_OUT and SPDIF registers. "i2s_in" contains
		a set of I2S_IN registers.
	- interrupts: audio DMA interrupt number
	- brcm,clk-mux-syscon: The syscon phandle for shared registers which
		control the port's audio mux clock and some of the i2s controls

Optional properties:
	- assigned-clocks: only valid choice is audiopll
	- assigned-clock-rates: clock frequency for audiopll
If none of the ports need an internal master clock then there no need to
initialize the pll clock.


SSP Subnode properties:
Required:
	- reg: The index of ssp port interface to use
		Valid value are 0, 1, 2, or 3 (for spdif)
Optional:
	- clocks: clock used by audio port
		  one of the audiopll outputs (see brcm,iproc-clocks.txt).
	- clock-names: Must be "ssp_clk"

Example:
	ssp_clkmux: syscon@180aea00 {
		compatible = "brcm,iproc-audio-ssp-syscon", "syscon";
		reg = <0x180aea00 0x100>;
	};

	cygnus_audio: audio@180ae000 {
		compatible = "brcm,cygnus-audio";
		#address-cells = <1>;
		#size-cells = <0>;
		reg = <0x180ae000 0xafd>, <0x180aec00 0x1f8>;
		reg-names = "aud", "i2s_in";

		assigned-clocks = <&audiopll BCM_CYGNUS_AUDIOPLL>;
		assigned-clock-rates = <1376255989>;

		interrupts = <GIC_SPI 143 IRQ_TYPE_LEVEL_HIGH>;

		brcm,clk-mux-syscon = <&ssp_clkmux>;

		ssp0: ssp_port@0 {
			reg = <0>;

			clocks = <&ssp0_clock>;
			clock-names = "ssp_clk";

			assigned-clocks = <&ssp0_clock>;
			assigned-clock-parents =
					<&audiopll BCM_CYGNUS_AUDIOPLL_CH0>;

			status = "okay";
		};

		ssp1: ssp_port@1 {
			reg = <1>;

			clocks = <&ssp1_clock>;
			clock-names = "ssp_clk";

			assigned-clocks = <&ssp1_clock>;
			assigned-clock-parents =
					<&audiopll BCM_CYGNUS_AUDIOPLL_CH1>;

			status = "okay";
		};

		ssp2: ssp_port@2 {
			reg = <2>;

			clocks = <&ssp2_clock>;
			clock-names = "ssp_clk";

			assigned-clocks = <&ssp2_clock>;
			assigned-clock-parents =
					<&audiopll BCM_CYGNUS_AUDIOPLL_CH1>;

			status = "okay";
		};

		spdif: spdif_port@3 {
			reg = <3>;

			clocks = <&spdiftx_clock>;
       			clock-names = "ssp_clk";

			assigned-clocks = <&spdiftx_clock>;
			assigned-clock-parents =
					<&audiopll BCM_CYGNUS_AUDIOPLL_CH2>;

			status = "disabled";
		};
	};
```

## Documentation/devicetree/bindings/sound/brcm,cygnus-svk-audio.txt
```
ASoC machine driver Cygnus SVK.
This board has an Cygnus SOC, and on board WM8750 codec.
This audio driver should work for all of the following SVK variants
	bcm911360k
	bcm958300k
	bcm958303k
	bcm958305k

Required properties:
- compatible: "bcm,cygnussvk-machine"

In addition to these properties, the device follows the general construct
of the multi-dai generic "simple audio card".  Refer to simple-card.txt.

The only valid dai properties for this design are
 - format
 - bitclock-master
 - frame-master

Optional properties:
The follow properties are only need if the tlv320aic3x codec is configure
on link0 or link1:
- brcm,bank-sel1-gpio and brcm,bank-sel1-gpio: Two gpios are used as
	selectors on a switch that will direct the other gpio signals
	(codec reset, headset-amp-en, and handsfree-amp-en, to either
	daughter card slot 0 or slot 1.
- brcm,ext-headset-amp-en-gpio = gpio used to control the enabling of
	the headset speaker amplifier.
- brcm,handsfree-amp-en-gpio: gpio used to conrol the enabling of the
	handsfree speaker amplifier.
- brcm,scslot: the daughter card slot that is populate with the tlv320aic3x
	codec (0 is slot 0, all else is slot 1).


Example:
sound {
	compatible = "brcm,cygnussvk-machine";
	status = "okay";

	brcm,bank-sel0-gpio = <&gpio_crmu 0 0>;
	brcm,bank-sel1-gpio = <&gpio_crmu 1 0>;

	brcm,ext-headset-amp-en-gpio = <&gpio_asiu 117 0>;
	brcm,handsfree-amp-en = <&gpio_asiu 119 0>;
	brcm,scslot = <1>; /* 0 = slot 0, all else = 1 */

	dai-link@0 {
		format = "i2s";
		bitclock-master = <&dailink0_master>;
		frame-master = <&dailink0_master>;

		dailink0_master: cpu {
			sound-dai = <&cygnus_audio 0>;
		};

		codec {
			sound-dai = <&bcm_dummy_codec>;
		};
	};

	dai-link@1 {
		format = "i2s";
		bitclock-master = <&dailink1_master>;
		frame-master = <&dailink1_master>;

		dailink1_master: cpu {
			sound-dai = <&cygnus_audio 1>;
		};

		codec {
			sound-dai = <&tlv320aic3x>;
		};
	};

	dai-link@2 {
		format = "i2s";
		bitclock-master = <&dailink2_master>;
		frame-master = <&dailink2_master>;

		dailink2_master: cpu {
			sound-dai = <&cygnus_audio 2>;
		};

		codec {
			sound-dai = <&wolfson_8750>;
		};
	};

	dai-link@3 {
		format = "i2s";
		bitclock-master = <&dailink3_master>;
		frame-master = <&dailink3_master>;

		dailink3_master: cpu {
			sound-dai = <&cygnus_audio 3>;
		};

		codec {
			sound-dai = <&spdif_dummy_tx>;
		};
	};
};
```

## Documentation/devicetree/bindings/sound/brcm,dummy_codec.txt
```
Generic dummy codec driver for Broadcom test

This driver is similar to the "dummy" driver found in the ASoC
framework, but we are allowing this driver to be a continuous
frame rate up to a maximum of 384 kHz.  Also, this driver uses
device tree, allowing the codec to be added in the card driver
via of nodes.

Required properties:
- compatible: "brcm,dummy_codec"
```

## Documentation/devicetree/bindings/sound/brcm,omega-audio.txt
```
Broadcom Omega Audio I2S/TDM/SPDIF controller

Required properties:
	- compatible : "brcm,omega-audio"
	- #address-cells: 32bit valued, 1 cell.
	- #size-cells:  32bit valued, 0 cell.
	- reg : Should contain audio registers location and length
	- reg-names: names of the registers listed in "reg" property
		Valid names are "aud" and "i2s_in".
	- interrupts: audio DMA interrupt number
	- brcm,clk-mux-syscon: The syscon phandle for shared registers which
		control the port's audio mux clock and some of the i2s controls

SSP Subnode properties:
Required:
	- reg: The index of ssp port interface to use
		Valid value are 0, 1, 2, or 3 (for spdif)
Optional:
	- clocks: clock used by audio port
	- clock-names: Must be "ssp_clk"

Example:
	omega_audio: audio@600000 {
		compatible = "brcm,omega-audio";
		#address-cells = <1>;
		#size-cells = <0>;
		reg = <0x00600000 0xb40>, <0x00600d70 0x1f8>;
		reg-names = "aud", "i2s_in";

		assigned-clocks = <&audiopll_0 BCM_OMEGA_AUDIOPLL>,
				  <&ssp0_clock>,
				  <&ssp1_clock>,
				  <&ssp2_clock>,
				  <&spdiftx_clock>;
		assigned-clock-rates = <1376255989>;
		assigned-clock-parents = <0>,
				<&audiopll_0 BCM_OMEGA_AUDIOPLL_CH0>,
				<&audiopll_0 BCM_OMEGA_AUDIOPLL_CH1>,
				<&audiopll_0 BCM_OMEGA_AUDIOPLL_CH2>,
				<&audiopll_0 BCM_OMEGA_AUDIOPLL_CH3>;

		interrupts = <GIC_SPI 86 IRQ_TYPE_LEVEL_HIGH>;

		brcm,clk-mux-syscon = <&ssp_clkmux>;

		ssp0: ssp_port@0 {
			reg = <0>;
			clocks = <&ssp0_clock>;
			clock-names = "ssp_clk";
			status = "okay";
		};

		ssp1: ssp_port@1 {
			reg = <1>;
			clocks = <&ssp1_clock>;
			clock-names = "ssp_clk";
			status = "okay";
		};

		ssp2: ssp_port@2 {
			reg = <2>;
			clocks = <&ssp2_clock>;
			clock-names = "ssp_clk";
			assigned-clocks = <&ssp2_clock>;
			status = "okay";
		};

		spdif: spdif_port@3 {
			reg = <3>;
			clocks = <&spdiftx_clock>;
			clock-names = "ssp_clk";
			status = "disabled";
		};
	};
```

## Documentation/devicetree/bindings/sound/brcm,omega-bcm91140x15-entphn.txt
```
Omega Enterprise Phone reference design

Required properties:
- compatible: "brcm,bcm91140x15_entphn-machine"

Optional properties:
- brcm,ext-headset-amp-en-gpio: gpio used to control the enabling of
	the mono headset speaker amplifier.

In addition to these properties, the device follows the general construct
of the multi-dai generic "simple audio card".  Refer to simple-card.txt.

Example:

sound {
	compatible = "brcm,bcm91140x15_entphn-machine";
	status = "okay";

	link0 {
		format = "dsp_a";
		bitclock-master = <&dailink0_master>;
		frame-master = <&dailink0_master>;

		cpu {
			sound-dai = <&omega_audio 2>;

			dai-tdm-slot-num = <8>;
			dai-tdm-slot-width = <32>;
			dai-tdm-slot-tx-mask = <1 1 1 1 0 0 0 0>;
			dai-tdm-slot-rx-mask = <1 1 1 1 0 0 0 0>;
		};

		dailink0_master: codec {
			sound-dai = <&omega_codec 0>;
		};
	};
};
```
