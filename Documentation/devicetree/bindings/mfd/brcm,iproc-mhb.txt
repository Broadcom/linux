## Documentation/devicetree/bindings/phy/brcm,sr-pcie-phy.txt
```
Broadcom Stingray PCIe PHY

* TBD whether to upstream or not based on Stingray A1 and Stingray+ design

Required properties:
- compatible: must be "brcm,sr-pcie-phy"
- brcm,sr-cdru: phandle to the CDRU syscon node
- brcm,sr-mhb: phandle to the MHB syscon node
- #phy-cells: Must be 1, denotes the PHY index

For PAXB based interfaces, PHY index goes from 0 to 7. PAXC uses index 8

Example:
	mhb: syscon@60401000 {
		compatible = "brcm,sr-mhb", "syscon";
		reg = <0 0x60401000 0 0x38c>;
	};

	cdru: syscon@6641d000 {
		compatible = "brcm,sr-cdru", "syscon";
		reg = <0 0x6641d000 0 0x400>;
	};

	pcie_phy: phy {
		compatible = "brcm,sr-pcie-phy";
		brcm,sr-cdru = <&cdru>;
		brcm,sr-mhb = <&mhb>;
		#phy-cells = <1>;
	};

	/* users of the PCIe PHY */

	pcie0: pcie@48000000 {
		...
		...
		phys = <&pcie_phy 0>;
		phy-names = "pcie-phy";
	};
```

## Documentation/devicetree/bindings/phy/brcm,stingray-pcie-phy-prbs.txt
```
Broadcom PCIe PHY PRBS for Stingray

Required PHY properties:
- compatible: should be "brcm,stingray-pcie-phy-prbs"
- reg: base address and length of the PCIe subsystem register space
- address-cells: should be 2
- size-cells: should be 2
- ranges : the child address space are mapped 1:1 onto the parent address space
- brcm,pcie-pipemux-strap-syscon: A phandle to the CDRU syscon node containing
				  the PIPEMUX strap register value.

Sub-nodes:
 Each PHY should be represented as a sub-node. It is required to list all
 the PCIe PHYs present in SoC as sub-nodes of pcie.

Sub-nodes required properties:
- reg: base address and length of the PCIe controller I/O register space

Example:
	pcie {
		compatible = "brcm,stingray-pcie-phy-prbs";
		reg = <0x0 0x40000000 0x0 0x1000>;
		#address-cells = <2>;
		#size-cells = <2>;
		ranges;
		brcm,pcie-pipemux-strap-syscon = <&cdru>;

		pcie_phy0: phy@48000000 {
			reg = <0x0 0x48000000 0x0 0x4000>;
			status = "okay";
		};

		pcie_phy1: phy@48004000 {
			reg = <0x0 0x48004000 0x0 0x4000>;
			status = "okay";
		};

		pcie_phy2: phy@48008000 {
			reg = <0x0 0x48008000 0x0 0x4000>;
			status = "okay";
		};

		pcie_phy3: phy@4800c000{
			reg = <0x0 0x4800c000 0x0 0x4000>;
			status = "okay";
		};

		pcie_phy4: phy@48010000 {
			reg = <0x0 0x48010000 0x0 0x4000>;
			status = "okay";
		};

		pcie_phy5: phy@48014000 {
			reg = <0x0 0x48014000 0x0 0x4000>;
			status = "okay";
		};

		pcie_phy6: phy@48018000 {
			reg = <0x0 0x48018000 0x0 0x4000>;
			status = "okay";
		};

		pcie_phy7: phy@4801c000 {
			reg = <0x0 0x4801c000 0x0 0x4000>;
			status = "okay";
		};
	};
```

## Documentation/devicetree/bindings/phy/brcm,stingray-sata-phy-prbs.txt
```
Broadcom SATA PHY PRBS for Stingray

Required properties:
- compatible : should be "brcm,stingray-sata-phy-prbs"
- address-cells: should be 1
- size-cells: should be 0
- reg: register ranges for the PHY PCB interface
- reg-names: should be "phy"

Sub-nodes:
  Each port's PHY should be represented as a sub-node.

Sub-nodes required properties:
- reg: the PHY number

Example:
	sata_phy0: sata_phy@67d02100 {
		compatible = "brcm,stingray-sata-phy-prbs";
		reg = <0x67d02100 0x1000>;
		reg-names = "phy";
		#address-cells = <1>;
		#size-cells = <0>;

		sata0_phy0: sata-phy@0 {
			reg = <0>;
		};
	};
```

## Documentation/devicetree/bindings/phy/brcm,stingray-usb-phy.txt
```
BROADCOM STINGRAY USB PHY

Required properties:
 - compatible : should be one of the listed compatibles
	- "brcm,sr-usb-phy"
	- "brcm,sr-usb-phy-v2"
 - reg: offset and length of the PHY blocks registers
 - address-cells: should be 1
 - size-cells: should be 0

Sub-nodes:
  Each port's PHY should be represented as a sub-node.

Sub-nodes required properties:
 - reg: required for brcm,sr-usb-phy model phy.
	reg value 0 is HS phy and 1 is SS phy.
 - phy-cells: generic PHY binding; must be 0

Refer to phy/phy-bindings.txt for the generic PHY binding properties

Example:
	usbphy0: usb-phy@68500000 {
		compatible = "brcm,sr-usb-phy";
		reg = <0x68500000 0x100>;
		#address-cells = <1>;
		#size-cells = <0>;

		usb0_phy0: phy@0 {
			reg = <0>;
			#phy-cells = <0>;
		};

		usb0_phy1: phy@1 {
			reg = <1>;
			#phy-cells = <0>;
		};
	};

	usbphy1: usb-phy@68510000 {
		compatible = "brcm,sr-usb-phy";
		reg = <0x68510000 0x100>,
		#address-cells = <1>;
		#size-cells = <0>;

		usb1_phy0: phy@0 {
			reg = <0>;
			#phy-cells = <0>;
		};

		usb1_phy1: phy@1 {
			reg = <1>;
			#phy-cells = <0>;
		};
	};

	usbphy2: usb-phy@68520000 {
		compatible = "brcm,sr-usb-phy-v2";
		reg = <0x68520000 0x100>,
		#address-cells = <1>;
		#size-cells = <0>;
		#phy-cells = <0>;
	};
```
