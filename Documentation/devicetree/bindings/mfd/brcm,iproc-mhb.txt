## Documentation/devicetree/bindings/mfd/brcm,iproc-mhb.txt
```
Broadcom iProc Multi Host Bridge (MHB)

Certain Broadcom iProc SoCs have a multi host bridge (MHB) block that controls
PCIe based access to an internally integrated NIC from external/internal hosts.
This node allows access to these MHB registers via syscon.

Required properties:
- compatible: should contain:
		"brcm,sr-mhb", "syscon" for Stingray
- reg: base address and range of the MHB registers

Example:
	mhb: syscon@60401000 {
		compatible = "brcm,sr-mhb", "syscon";
		reg = <0 0x60401000 0 0x38c>;
	};
```

## Documentation/devicetree/bindings/misc/brcm,iproc-dte.txt
```
Broadcom Digital Timing Engine (DTE) Device Tree Bindings
-------------------------------------------------------------

Required properties:
	- compatible: Should contain the core DTE compatibility string
		      and the SoC compatibility string. The SoC specific
		      compatibility string is to account for SoC specific
		      hardware differences.
		      DTE compatibility Strings:
			"brcm,iproc-dte"
		      SoC compatibility Strings:
			"brcm,cygnus-dte"
			"brcm,stingray-dte"
	- reg       : Address and size of the DTE registers.
		      Address and size of ASIU_TOP_MISC2 register (optional)
	- reg-names : Must name "dte_primary", and optionally "dte_trigg"
		      If using Omega SoC must also name "dte_nco"

Optional properties:
	- interrupts: DTE IIG Interrupt number
	              If intr number is not specified DTE uses
	              software timer mode for reading the hw
	              fifo.
	- brcm,dte-interval-ns: DTE IRQ interval in nanoseconds for
	               generation of ITG (used to get data from
	               h/w FIFO).
	               If unspecified the default from the driver
	               is used. default value 0.5 sec


Examples:
1.
	/* Cygnus (ISR mode) */
	dte: dte@180af000 {
		compatible = "brcm,cygnus-dte", "brcm,iproc-dte";

		reg = <0x180af000 0x1000>, <0x180aa054 0x4>;
		reg-names = "dte_primary", "dte_trigg";

		interrupts = <GIC_SPI 144 IRQ_TYPE_LEVEL_HIGH>;
		brcm,dte-interval-ns = <500000000>;
		status = "okay";
	};

2.
	/* Stingray (Soft-timer mode) */
	dte: dte@180af000 {
		compatible = "brcm,stingray-dte", "brcm,iproc-dte";

		reg = <0x180af000 0x1000>;
		reg-names = "dte_primary";

		brcm,dte-interval-ns = <500000000>;
		status = "okay";
	};

3.
	/* Omega */
	dte: dte@601700 {
		compatible = "brcm,omega-dte", "brcm,iproc-dte";

		reg = <0x601700 0x100>, <0x601600 0x24>;
		reg-names = "dte_primary", "dte_nco";

		status = "disabled";
	};
```

## Documentation/devicetree/bindings/misc/brcm,iproc-ftm.txt
```
Flextimer support for reading  magnetic stripe of smart cards.

Magnetic stripe reader head reads the smart card's magnetic stripe flux
and generates the analog signal. This signal is digitalized and fed to
flex time which time stamp the data. Time stamp is decoded to get the stripe
tracks data.


Required properties:

- compatible:
    Must be "brcm,iproc-ftm"

-reg:
	base address of flex channels registers.

-flextimer_syscon:
	handler of syscon node defining physical base address of the
	TS/ADC controller and length of memory mapped region.

-interrupts:
	interrupt line used by flex timer.

-clocks and clock-names:
	clock used in flex timer.clock-names must be "ftm_clk".

-pinctrl-0:
	configure the mux to activate pin for flex timer functionalites.

For example:

	ts_adc_syscon: ts_adc_syscon@180a6000 {
		compatible = "brcm,iproc-ts-adc-syscon", "syscon";
		reg = <0x180a6000 0xc30>;
	};

	flextimer: flextimer@180a6000 {
		compatible = "brcm,iproc-ftm";
		flextimer_syscon = <&ts_adc_syscon>;
		interrupts = <GIC_SPI 164 IRQ_TYPE_LEVEL_HIGH>;
		clocks = <&asiu_clks BCM_CYGNUS_ASIU_ADC_CLK>;
		clock-names = "ftm_clk";
		pinctrl-0 = <&flextimer_default_mux>;
		status = "disabled";
	};
```

## Documentation/devicetree/bindings/misc/brcm,nvme-lpm-ssr.txt
```
Broadcom NVME/SSR data backup device tree binding

Required_properties:
	-compatible: must be "brcm,nvme-lpm-data-backup".
	- reg: memory address used for sharing SSR commands/data.
	- intrpt-gpio: GPIO that is asserted when PMIC detect 12V supply loss
		       and de-asserted when suply gets re-stored.
	- mboxes: list of phandle and mailbox channel specifier,
		  used for communication with a power management co-processor.
	- memory-region : phandle to a node describing reserved memory region
			  for sharing data of NVMe device used for data-backup
			  with power management co-processor.

Example:
	reserved-memory {
		#address-cells = <2>;
		#size-cells = <2>;
		ranges;

		pci_lpm_region: pci_lpm_region@801f0000 {
			reg = <0x0 0x8f101000 0x0 0x1000>;
			no-map;
		};
	};

	nvme_lpm_data_backup: nvme-lpm-data-backup@14 {
		compatible = "brcm,nvme-lpm-data-backup";
		reg = <0x0 0x100>;
		intrpt-gpio = <&gpio_hsls 2 GPIO_ACTIVE_HIGH>;
		mboxes = <&mailbox 0>;
		memory-region = <&pci_lpm_region>;
		status = "disabled";
	};
```

## Documentation/devicetree/bindings/misc/brcm,smart-card.txt
```
Broadcom Smart Card Reader driver used for chip based Cards.

Required properties:

- compatible:
	Must be "brcm,smart-card"

-reg:
	base address of SCI registers

-reg-names:
	Should contain strings with the following names, each
	representing a specific internal memory region.
	list of reg-names
	"sc-uart-cmd1".

-sc_syscon:
	handler of syscon node defining interrupt registers base address of the
	smartcard interface and length of memory mapped region.

-interrupts:
	One interrupt line is used by each SCI.

-interrupt-names:
	A list of interrupt names. Should contain (if present):
		- "sci-irq" for smartcard interface,

-clocks:
	Smart Card Clock.

-pinctrl-0:
	mux setting used to configure pins for smart card.

-sci-id:
	Smart Card Id. 0 for first smart card interface and 1 for second.

-nxp-coupler:
	Coupler used for interfacing between card and controller.
	0 for NXP8024, 1 for NXP8026(with i2c1)

For example:

	smartcard_syscon: smartcard_syscon@180a3200 {
		compatible = "brcm,smart-card-syscon", "syscon";
		reg = <0x180a3200 0x28>;
	};

	smartcard0: smartcard@180a3000 {
		compatible = "brcm,smart-card";
		reg = <0x180a3000 0x100>;
		reg-names = "sc-uart-cmd1";
		sc_syscon = <&smartcard_syscon>;
		interrupts = <GIC_SPI 161 IRQ_TYPE_LEVEL_HIGH>;
		interrupt-names = "sci-irq";
		clocks = <&lcpll0_clks BCM_CYGNUS_LCPLL0_SMART_CARD_CLK>;
		pinctrl-0 = <&smartcard_0>;
		sci-id = <0>;
		nxp-coupler = <0> ;
		/* 0 for NXP8024, 1 for NXP8026(with i2c1) */
		 * NXP8024 and NXP8026 are smartcard interfaces/slots.
		 * NXP8024 is IC based interface and not i2c.
		 * NXP8026 is i2c based interface and supports multiple slots.
		 */
		status = "disabled";
	};
```

## Documentation/devicetree/bindings/misc/mmap,cmem.txt
```
Broadcom CMEM Device Tree Bindings
-------------------------------------------------------------
This binding defines the reserved physical memory address and its size
used to map to user mode virtual address for VFIO

Required properties:
	- compatible    : Should contain the CMEM compatibility string
		          "mmap-cmem"
	- reg           : Physical base address and size of the
		          Reserved memory
	- memory-region : phandle to a node describing reserved memory
			  region.

Examples:
	reserved-memory {
		#address-cells = <2>;
		#size-cells = <2>;
		ranges;

		cmem_region: cmem_region@90000000 {
			reg = <0x0 0x90000000 0x0 0x1000000>;
			no-map;
		};
	};

	cmem: cmem@0 {
		compatible = "mmap-cmem";
		memory-region = <&cmem_region>;
	};
```

## Documentation/devicetree/bindings/mtd/brcm,bcm281xx-nand.txt
```
Broadcom BCM281xx Soc NAND controller DT binding

The Broadcom BCM281XX NAND controller provides an interface to control
the NAND flash chips for bcm28155_ap based platforms.

Required properties:

- compatible:  Should be "brcm,nand-bcm281xx".
- reg:         The base physical address and size of
               NAND controller's registers.
- clocks:      The clocks needed by the NAND controller
- clock-names: Should contain the clock name "nand_clk".
- status:      Disabled default. Then set "okay" by platform.

Example:

nand: nand@3f110000 {
	compatible = "brcm,nand-bcm281xx";
	reg = <0x3f110000 0x10000>;
	clocks = <&master_ccu BCM281XX_MASTER_CCU_NAND>;
	clock-names = "nand_clk";
	status = "disabled";
};
```

## Documentation/devicetree/bindings/net/brcm,amac-enet.txt
```
Broadcom AMAC Ethernet Controller Device Tree Bindings
-------------------------------------------------------------

Required properties:
 - compatible: "brcm,amac-enet" - For Cygnus SoC and NS2 A0/A1 SoC
	       "brcm,amac-enet-v2" - For NS2 B0/B1 Soc
 - reg       : Physical base address and size of the
               ethernet registers.
               required: core_base, amac_idm_base
               optional: switch_global_base, crmu_io_pad_ctrl,
	       rgmii_base
                switch_global_base - When this reg is defined
                  along with 'brcm,enet-switch-mode', the AMAC
                  driver will configure for switch-by-pass-mode.
                  This connectes the MAC directly to the PHY
                  (attached to Port0).
                crmu_io_pad_ctrl - This reg is required in some
                  SoC's for performing IO PAD configurations.
		rgmii_base - This reg is required in some SoC's
		  for performing rgmii initialization.
 - reg-names : Register names. Used in the driver to get
	       the register data
               required: "core_base", "amac_idm_base",
               optional: "switch_global_base", "crmu_io_pad_ctrl",
	       "rgmii_base"
 - interrupts: AMAC Interrupt number
 - max-speed : max speed for the internal/external port

Optional properties:
 - brcm,enet-switch-mode : Indicates the availability of an internal
               switch. In the absence of this setting the AMAC driver
               works in switch-by-pass mode. In some SoC's
               (with internal switch), this requires specifying the
               'switch_global_base' reg to configure the
               switch-by-pass mode.
 - phy-handle: phandle of the phy to be used in switch-by-pass mode
               This typically can only be the PHY0 (in case of SoC's
               with an internal switch).
 - brcm,enet-phy-lswap: Enable lane swap logic for the port. The
               existence of the property will enable the feature.
 - brcm,enet-pause-disable: Disable the PAUSE frame setting of the PHY
               by overriding the PHY setting (restarts auto-neg during
               init).
               The existence of the property will disable PAUSE frames.
 - brcm,enet-phy54810-rgmii-sync: BCM PHY54810 fix up needed to work in harmony
	       with RGMII for some SoCs.
 - dma-coherent: Present if dma operations are coherent.

SoC's that require "crmu_io_pad_ctrl" reg:
------------------------------------------
 - Cygnus

SoC's with an internal switch & can run in switch-by-pass mode:
---------------------------------------------------------------
 - Cygnus

SoC's that require "rgmii_base" reg:
------------------------------------
 - NS2

SoC's that require "brcm,enet-phy54810-rgmii-sync" property:
------------------------------------------------------------
 - NS2

Examples:

1. Port0 is 1G LAN in "switch-by-pass" mode for Cygnus SoC with pause
   frames disabled:

	mdio: mdio@18002000 {
		compatible = "brcm,iproc-mdio";
		reg = <0x18002000 0x8>;
		#size-cells = <1>;
		#address-cells = <0>;

		gphy0: eth-gphy@0 {
			reg = <0>;
			max-speed = <1000>;
			phy-mode = "mii";
		};
	};

	enet: enet@0x18042000 {
		compatible = "brcm,amac-enet";
		reg = <0x18042000 0x1000>,
			<0x18110400 0x1000>,
			<0x0301d194 0x4>,
			<0x0301d0bc 0x4>;
		reg-names = "core_base",
			"amac_idm_base",
			"switch_global_base",
			"crmu_io_pad_ctrl";
		interrupts = <GIC_SPI 110 IRQ_TYPE_LEVEL_HIGH>;
		phy-handle = <&gphy0>;
		brcm,enet-pause-disable;
		status="okay";
	};

2. Port0 is 1G LAN in "Switch" mode for Cygnus SoC:

        mdio: mdio@18002000 {
                compatible = "brcm,iproc-mdio";
                reg = <0x18002000 0x8>;
                #size-cells = <1>;
                #address-cells = <0>;

                gphy0: eth-gphy@0 {
                        reg = <0>;
                        max-speed = <1000>;
                        phy-mode = "mii";
                };
        };

        enet: enet@0x18042000 {
                compatible = "brcm,amac-enet";
                reg = <0x18042000 0x1000>,
                        <0x18110400 0x1000>,
                        <0x0301d0bc 0x4>;
                reg-names = "core_base",
                        "amac_idm_base",
                        "crmu_io_pad_ctrl";
                interrupts = <GIC_SPI 110 IRQ_TYPE_LEVEL_HIGH>;
                brcm,enet-switch-mode;
                phy-handle = <&gphy0>;
                status="okay";
        };

3. Port0 is 1G LAN in "switch-by-pass" mode for NS2 A0/A1 SoC with pause
   frames disabled:

	iproc_shared_mdio: iproc_shared_mdio@6602023c {
		compatible = "brcm,iproc-shared-mdio";
		reg = <0x6602023c 0x14>;
		reg-names = "mdio";
		#address-cells = <1>;
		#size-cells = <0>;
	};

	&iproc_shared_mdio {
		eth-master@0 {
			compatible = "brcm,iproc-mdio-master-eth";
			reg = <0x0>;
			#address-cells = <1>;
			#size-cells = <0>;
			status = "ok";

			gphy0: eth-phy@10 {
				reg = <0x10>;
				phy-mode = "mii";
			};
		};
	};

	enet: enet@61000000 {
		compatible = "brcm,amac-enet";
		reg = <0x61000000 0x1000>,
			<0x61090400 0x1000>,
			<0x61030000 0x10>;
		reg-names = "core_base",
			"amac_idm_base",
			"rgmii_base";
		dma-coherent;
		interrupts = <GIC_SPI 341 IRQ_TYPE_LEVEL_HIGH>;
		max-speed = <1000>;
		phy-handle = <&gphy0>;
		brcm,enet-phy54810-rgmii-sync;
		brcm,enet-pause-disable;
		status= "okay";
	};

4. Port0 is 1G LAN in "switch-by-pass" mode for NS2 B0/B1 SoC with pause
   frames disabled:

	iproc_shared_mdio: iproc_shared_mdio@6602023c {
		compatible = "brcm,iproc-shared-mdio";
		reg = <0x6602023c 0x14>;
		reg-names = "mdio";
		#address-cells = <1>;
		#size-cells = <0>;
	};

	&iproc_shared_mdio {
		eth-master@0 {
			compatible = "brcm,iproc-mdio-master-eth";
			reg = <0x0>;
			#address-cells = <1>;
			#size-cells = <0>;
			status = "ok";

			gphy0: eth-phy@10 {
				reg = <0x10>;
				phy-mode = "mii";
			};
		};
	};

	enet: enet@61000000 {
		compatible = "brcm,amac-enet-v2";
		reg = <0x61000000 0x1000>,
			<0x61090400 0x1000>,
			<0x61030000 0x10>;
		reg-names = "core_base",
			"amac_idm_base",
			"rgmii_base";
		dma-coherent;
		interrupts = <GIC_SPI 341 IRQ_TYPE_LEVEL_HIGH>;
		max-speed = <1000>;
		phy-handle = <&gphy0>;
		brcm,enet-phy54810-rgmii-sync;
		brcm,enet-pause-disable;
		status= "okay";
	};
```
