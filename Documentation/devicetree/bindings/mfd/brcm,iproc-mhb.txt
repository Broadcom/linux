## Documentation/devicetree/bindings/net/brcm,amac.txt
```
Broadcom AMAC Ethernet Controller Device Tree Bindings
-------------------------------------------------------------

Required properties:
 - compatible:	"brcm,amac"
		"brcm,amac-v2" - for v2 amac supporting WOL feature
		"brcm,nsp-amac"
		"brcm,ns2-amac"
 - reg:		Address and length of the register set for the device. It
		contains the information of registers in the same order as
		described by reg-names
 - reg-names:	Names of the registers.
		"amac_base":	Address and length of the GMAC registers
		"idm_base":	Address and length of the GMAC IDM registers
				(required for NSP and Northstar2)
		"switch_global_base": Address of the switch config register
		"nicpm_base":	Address and length of the NIC Port Manager
				registers (required for Northstar2)
 - interrupts:	Interrupt number

Optional properties:
- mac-address:	See ethernet.txt file in the same directory
- brcm,amac-switch-bypass:  This configuration is to by pass the internal
			    switch (if available). With the switch
			    disabled only Port 0 will function in those
			    SoC's.

Examples:

amac0: ethernet@18022000 {
	compatible = "brcm,nsp-amac";
	reg = <0x18022000 0x1000>,
	      <0x18110000 0x1000>;
	reg-names = "amac_base", "idm_base";
	interrupts = <GIC_SPI 147 IRQ_TYPE_LEVEL_HIGH>;
};
```

## Documentation/devicetree/bindings/net/brcm,bt-rfkill.txt
```
Broadcom Bluetooth RFKILL Driver

Required Properties:
- compatible: Must be "brcm,bt-rfkill"
- brcm,rfkill-regulator: List of phandles to regulator nodes. These regulators
    are disabled when the rfkill state is set to 0 and enabled when set to 1.

Optional Properties:
- bt-dev-wake-gpio: Device wake GPIO.
- bt-host-wake-gpio: Host wake GPIO.

Example:

bluetooth {
	compatible = "brcm,bt-rfkill";
	brcm,rfkill-regulator = <&rf_reg0>;
	bt-dev-wake-gpio = <&gpio_asiu 87 0>;
	bt-host-wake-gpio = <&gpio_crmu 4 0>;
};
```

## Documentation/devicetree/bindings/net/broadcom-amac.txt
```
Broadcom AMAC Ethernet Controller Device Tree Bindings
-------------------------------------------------------------

Required properties:
 - compatible: "brcm,amac-enet" - For Cygnus SoC
 - reg       : Physical base address and size of the
               ethernet registers.
               required: core_base, amac_idm_base
               optional: switch_global_base, crmu_io_pad_ctrl
                switch_global_base - When this reg is defined
                  along with 'brcm,enet-switch-mode', the AMAC
                  driver will configure for switch-by-pass-mode.
                  This connectes the MAC directly to the PHY
                  (attached to Port0).
                crmu_io_pad_ctrl - This reg is required in some
                  SoC's for performing IO PAD configurations.
 - reg-names : Register names. Used in the driver to get
	       the register data
               required: "core_base", "amac_idm_base",
               optional: "switch_global_base", "crmu_io_pad_ctrl"
 - interrupts: AMAC Interrupt number
 - max-speed : max speed for the internal port

Optional properties:
 - brcm,enet-switch-mode : Indicates the availability of an internal
               switch. In the absence of this setting the AMAC driver
               works in switch-by-pass mode. In some SoC's
               (with internal switch), this requires specifying the
               'switch_global_base' reg to configure the
               switch-by-pass mode.
 - phy-handle: phandle of the phy to be used in switch-by-pass mode
               This typically can only be the PHY0 (in case of SoC's
               with an internal switch).
 - port-lswap: Enable lane swap logic for the port. The existence
               of the configuration will enable the feature.

SoC's that require "crmu_io_pad_ctrl" reg:
------------------------------------------
 - Cygnus

SoC's with an internal switch & can run in switch-by-pass mode:
---------------------------------------------------------------
 - Cygnus

Examples:

1. Port0 is 1G LAN in "switch-by-pass" mode for Cygnus SoC:

	mdio: mdio@18002000 {
		compatible = "brcm,iproc-mdio";
		reg = <0x18002000 0x8>;
		#size-cells = <1>;
		#address-cells = <0>;

		gphy0: eth-gphy@0 {
			reg = <0>;
			max-speed = <1000>;
			phy-mode = "mii";
		};
	};

	enet: enet@0x18042000 {
		compatible = "brcm,amac-enet";
		reg = <0x18042000 0x1000>,
			<0x18110400 0x1000>,
			<0x0301d194 0x4>,
			<0x0301d0bc 0x4>;
		reg-names = "core_base",
			"amac_idm_base",
			"switch_global_base",
			"crmu_io_pad_ctrl";
		interrupts = <GIC_SPI 110 IRQ_TYPE_LEVEL_HIGH>;
		phy-handle = <&gphy0>;
		status="okay";
	};

2. Port0 is 1G LAN in "Switch" mode for Cygnus SoC:

        mdio: mdio@18002000 {
                compatible = "brcm,iproc-mdio";
                reg = <0x18002000 0x8>;
                #size-cells = <1>;
                #address-cells = <0>;

                gphy0: eth-gphy@0 {
                        reg = <0>;
                        max-speed = <1000>;
                        phy-mode = "mii";
                };
        };

        enet: enet@0x18042000 {
                compatible = "brcm,amac-enet";
                reg = <0x18042000 0x1000>,
                        <0x18110400 0x1000>,
                        <0x0301d0bc 0x4>;
                reg-names = "core_base",
                        "amac_idm_base",
                        "crmu_io_pad_ctrl";
                interrupts = <GIC_SPI 110 IRQ_TYPE_LEVEL_HIGH>;
                brcm,enet-switch-mode;
                phy-handle = <&gphy0>;
                status="okay";
        };
```

## Documentation/devicetree/bindings/nvmem/brcm,28nm-ocotp.txt
```
Broadcom 28NM OTP memory controller

Required Properties:
- compatible: Must be "brcm,28nm-ocotp"
- reg: Base address of the OTP controller.
- brcm,ocotp-size: Amount of memory available, in 32 bit words

Example:

otp: otp@0301c800 {
	compatible = "brcm,28nm-ocotp";
	reg = <0x0301c800 0x2c>;
	brcm,ocotp-size = <2048>;
};
```

## Documentation/devicetree/bindings/nvmem/brcm,ocotp.txt
```
Broadcom OTP memory controller

Required Properties:
- compatible:
	"brcm,ocotp" for the first generation Broadcom OTPC
which is used in Cygnus, supports 32 bit read/write.
	"brcm,ocotp-v2" for the second generation Broadcom OTPC
which is used in SOC like Stingray, supports 64bit read/write.
- reg: Base address of the OTP controller.
- brcm,ocotp-size: Amount of memory available, in 32 bit words

Example:

otp: otp@0301c800 {
	compatible = "brcm,ocotp";
	reg = <0x0301c800 0x2c>;
	brcm,ocotp-size = <2048>;
};
```

## Documentation/devicetree/bindings/pci/brcm,iproc-pciehp.yaml
```yaml
# SPDX-License-Identifier: (GPL-2.0 or BSD-2-Clause)
%YAML 1.2
---
$id: http://devicetree.org/schemas/pci/brcm,pcie-ep.yaml#
$schema: http://devicetree.org/meta-schemas/core.yaml#

title: Broadcom iProc PCIe Root Complex Hotplug Device Tree Bindings

properties:
  compatible:
    const: brcm,iproc-pciehp

  reg:
    maxItems: 1

  interrupts:
    maxItems: 1
      - description: PCIe Link change interrupt line number

  brcm,iproc-pciehp-rc:
      - description: phandle to PCIe host controller device node

required:
  - reg
  - interrupts
  - brcm,iproc-pciehp-rc

examples:

    pciehp0: pciehp@02a00000 {
        compatible = "brcm,iproc-pciehp";
        reg = <0x0 0x02a00000  0x0 0x1000>;
        interrupts = <GIC_SPI 262 IRQ_TYPE_LEVEL_HIGH>;
        brcm,iproc-pciehp-rc = <&pcie0>;
    };
```

## Documentation/devicetree/bindings/pci/brcm,pcie-ep.yaml
```yaml
# SPDX-License-Identifier: (GPL-2.0 or BSD-3-Clause)
%YAML 1.2
---
$id: http://devicetree.org/schemas/pci/brcm,pcie-ep.yaml#
$schema: http://devicetree.org/meta-schemas/core.yaml#

title: Broadcom PCIe Endpoint Controller Device Tree Bindings

properties:
  compatible:
    const: brcm,pcie-ep

  reg:
    maxItems: 2
    items:
      - description: PCIe register base address and size
      - description: PCIe outbound address and size

  reg-names:
    minItems: 2
    items:
      - const: paxb-base
      - const: ob-mem-base

  brcm-ep-name:
    description: Endpoint controller name

required:
  - reg
  - reg-names
  - brcm-ep-name

examples:

    pcie_ep: pcie_ep@4e100000 {
        compatible = "brcm,pcie-ep";
        reg = <0x0 0x4e100000 0x0 0x00001000>, <0x1 0x08000000 0x0 0x08000000>;
        reg-names = "paxb-base", "ob-mem-base";
        brcm-ep-name = "4e100000.pcie_ep";
    };
```

## Documentation/devicetree/bindings/phy/brcm,iproc-mdio-master-pci.txt
```
* Broadcom NS2 PCIe PHY binding document

Required properties:
- compatible: should be "brcm,ns2-pcie-phy"
- brcm,phy_internal: NS2 only has internal MDIO phys
- reg: MDIO chain number for the MDIO interface
- #address-cells: must be 1
- #size-cells: must be 0

This is a child node of "brcm,iproc-shared-mdio"

Required properties for child nodes:
- reg: MDIO Phy ID for the MDIO interface
- #phy-cells: must be 0


Example:

pci-master@0 {
	compatible = "brcm,ns2-pcie-phy";
	brcm,phy_internal;
	reg = <0x0>;
	#address-cells = <1>;
	#size-cells = <0>;

	pci_phy0: pci-phy@0 {
		reg = <0x0>;
		#phy-cells = <0>;
	};
};
```

## Documentation/devicetree/bindings/phy/brcm,ns2-sata-phy.txt
```
Broadcom SATA3 PHY for Northstar2

Required properties:
- compatible: must be "brcm,ns2-sata-phy"
- address-cells: should be 1
- size-cells: should be 0
- reg: base address and length of the NS2 SATA PHY block
- reg-names: should be "phy"

Sub-nodes:
  Each port's PHY should be represented as a sub-node.

Sub-nodes required properties:
- reg: the PHY number
- phy-cells: generic PHY binding; must be 0

Example:
	sata_phy: sata_phy@663f0000 {
		compatible = "brcm,ns2-sata-phy";
		reg = <0x663f0000 0x2000>;
		reg-names = "phy";
		#address-cells = <1>;
		#size-cells = <0>;

		sata-phy@0 {
			reg = <0>;
			#phy-cells = <0>;
		};

		sata-phy@1 {
			reg = <1>;
			#phy-cells = <0>;
		};
	};
```

## Documentation/devicetree/bindings/phy/brcm,ns2-usb2-phy.txt
```
BROADCOM NORTHSTAR2 USB2 HOST PHY

This USB 2.0 host PHY is used in Northstar2 platform.
There are two such PHYs connected to two EHCI/OHCI controllers.

Required PHY properties:
 - compatible: brcm,ns2-usb2-phy
 - reg: Address and length of the NS2 PHY related registers.
 - reg-names:
   The below registers must be provided.
	usb2-idm-ctl: IDM control registers
	usb2-phy-ctl: Phy control registers
	usb2-icfg-sts: ICFG register to check PLL lock status
 - #phy-cells: Must be 0. No args required.
 - usb-ctl-syscon: Handler of syscon node to access NS2 CRMU USB
	control registers. There are 2 registers - one for USB2
	 and other for USB3.
 - brcm,ns2-usbh-afe: The AFE bit value for USB2 phy

Optional PHY properties:
 - brcm,ns2-inv-ppc-pol: This property is optional. This can be
	provided when ppc inversion/overcurrent polarity bits needs
	to be reversed in the ehci_ohci_strap register.

Required CRMU USB control properties:
 - compatibility strings: "brcm,ns2-crmu-usbctl", "syscon"
 - reg: The CRMU USB control registers address and length.
	There are 2 registers - one each for USB2 and USB3.

Refer to phy/phy-bindings.txt for the generic PHY binding properties

Example:
	crmu_usb_ctl: syscon@6501d144 {
		compatible = "brcm,ns2-crmu-usbctl", "syscon";
		reg = <0x6501d144 0x8>;
	};

	usbphy0: usbphy@67010800 {
		#phy-cells = <0>;
		compatible = "brcm,ns2-usb2-phy";
		reg = <0x67010408 0x400>,
		      <0x66490200 0x600>,
		      <0x66000888 0x4>;
		reg-names = "usb2-idm-ctl",
			    "usb2-phy-ctl",
			    "usb2-icfg-sts";
		usb-ctl-syscon = <&crmu_usb_ctl>;
		brcm,ns2-usbh-afe = <13>;
	};
```

## Documentation/devicetree/bindings/phy/brcm,ns2-usb3-phy.txt
```
Broadcom USB3 dual port phy for Northstar2 SoC

This is a child bus node of "brcm,mdio-mux-iproc" node.

Required mdio bus properties:
 - reg: MDIO Bus number for the MDIO interface
 - #address-cells: must be 1
 - #size-cells: must be 0

Required PHY properties:
 - compatible: should be "brcm,ns2-usb3-phy"
 - reg: Phy address in the MDIO interface
 - usb3-icfg-syscon: handler of syscon node for usb3 phy icfg region
 - usb3-idm-syscon: handler of syscon node for usb3 phy idm control
		    registers
 - #phy-cells: must be 0
 - #address-cells: must be 1
 - #size-cells: must be 0

Sub-nodes:
  Each port's PHY should be represented as a sub-node.

Sub-nodes required properties:
 - reg: the PHY number
 - phy-cells: from the generic PHY bindings, must be 0

Required usb3 phy icfg config properties:
 - compatible: should be "brcm,ns2-usb3-icfg-ctl"
 - reg: offset and length of the icfg control registers

Required usb3 reset control properties:
 - compatible: should be "brcm,ns2-usb3-idm-ctl"
 - reg: offset and length of the idm control registers

Optional PHY properties:
 - brcm,ns2-inv-vbus-ppc-pol: This property is optional. This can be
	provided when vbus ppc polarity bits needs to be reversed
	in the idm_ppc_cfg register.

Example:

mdio@1 {
	reg = <0x1>;
	#address-cells = <1>;
	#size-cells = <0>;

	usb3_phy: usb3-phy@0 {
		compatible = "brcm,ns2-usb3-phy";
		reg = <0x0>;
		#address-cells = <1>;
		#size-cells = <0>;
		usb3-icfg-syscon = <&usb3_icfg_ctl>;
		usb3-idm-syscon = <&usb3_idm_ctl>;

		usb3_phy0: usb3-phy@0 {
			reg = <0>;
			#phy-cells = <0>;
		};

		usb3_phy1: usb3-phy@1 {
			reg = <1>;
			#phy-cells = <0>;
		};
	};
};

usb3_icfg_ctl: syscon@66000910 {
	compatible = "brcm,ns2-usb3-icfg-ctl", "syscon";
	reg = <0x66000910 0x14>;
};

usb3_idm_ctrl: syscon@67000800 {
	compatible = "brcm,ns2-usb3-idm-ctl", "syscon";
	reg = <0x67000800 0x1808>;
};
```

## Documentation/devicetree/bindings/phy/brcm,omega-pcie-phy.txt
```
Broadcom Omega PCIe PHY

Required properties:
- compatible: must be "brcm,omega-pcie-phy"
- #address-cells: must be 1
- #size-cells: must be 0
- brcm,pciephy-crmu-syscon: a phandle to the crmu syscon area that contains phy
                            control regs.

PCIe PHY should be represented by a child node.

Required properties For the child node:
- reg: the PHY number, must be 0
- #phy-cells: must be 0

Example:
	pcie_phy: {
		compatible = "brcm,omega-pcie-phy";
		#address-cells = <1>;
		#size-cells = <0>;

		brcm,pciephy-crmu-syscon = <&crmu_syscon>;

		pcie0_phy: phy@0 {
			reg = <0>;
			#phy-cells = <0>;
		};
	};

	/* users of the PCIe phy */

	pcie0: pcie@28420000 {
		...
		...
		phys = <&pcie0_phy>;
		phy-names = "pcie-phy";
	};
```

## Documentation/devicetree/bindings/phy/brcm,omega-usb-phy.txt
```
BROADCOM OMEGA USB PHY

Required Properties:
- compatible:  brcm,omega-usb-phy
- reg : cdru usb phy (hs_ss_icfg_usb20phy) control and reset registers,
  usb host idm registers.
- reg-names: a list of the names corresponding to the previous register
  ranges. Should contain "cdru-usbphy", "usb2h-idm".
- address-cells: should be 1
- size-cells: should be 0
- brcm,usbphy-crmu-syscon:  a phandle to the crmu syscon area that contains phy
                            control regs.

Sub-nodes:
  A port PHY should be represented as a sub-node.

Sub-nodes required properties:
- reg: the PHY number, must be 0
- #phy-cells must be 0

Optional Properties:
- vbus-supply : The regulator for vbus out control.

Refer to phy/phy-bindings.txt for the generic PHY binding properties

Example of phy :
	usbphy: phy@28430100 {
		compatible = "brcm,omega-usb-phy";
		reg = <0x28430100 0x3c>,
		      <0x28800000 0xa00>;
		reg-names = "cdru-usbphy",
                                   "usb2h-idm";
		#address-cells = <1>;
		#size-cells = <0>;

		brcm,usbphy-crmu-syscon = <&crmu_syscon>;

		usbphy0: phy@0 {
			#phy-cells = <0>;
			reg = <0>;
		};
	};

Example of node using the phy:
	ehci: usb@28400000 {
		compatible = "generic-ehci";
		reg = <0x28400000 0x100>;
		interrupts = <GIC_SPI 82 IRQ_TYPE_LEVEL_HIGH>;
		phys = <&usbphy0>;
		phy-names = "usbp0";
		status = "okay";
	};
```
