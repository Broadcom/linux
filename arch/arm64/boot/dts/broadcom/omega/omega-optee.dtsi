// SPDX-License-Identifier: (GPL-2.0 or BSD-3-Clause)
/*
 *  Copyright(c) 2018 Broadcom
 */
#ifndef ENABLE_OPTEE
#define ENABLE_OPTEE	0
#endif

#if (ENABLE_OPTEE == 1)
	firmware {
		optee {
			compatible = "linaro,optee-tz";
			method = "smc";
		};
	};
#endif

