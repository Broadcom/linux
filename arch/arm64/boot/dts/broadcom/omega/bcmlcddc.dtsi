// SPDX-License-Identifier: (GPL-2.0 or BSD-3-Clause)
/*
 *  Copyright(c) 2018 Broadcom
 */

/*
 * Broadcom LCD daughter card (bcmlcddc) installed on bcm95831x SVK boards
 */

&clcd {
	status = "okay";
	panel {
		panel-timing {
			clock-frequency = <30000000>;
			hactive = <800>;
			hback-porch = <88>;
			hfront-porch = <40>;
			hsync-len = <48>;
			vactive = <480>;
			vback-porch = <32>;
			vfront-porch = <13>;
			vsync-len = <3>;
			vsync-active = <1>;
			hsync-active = <1>;
			pixelclk-active = <1>;
		};
	};
};
