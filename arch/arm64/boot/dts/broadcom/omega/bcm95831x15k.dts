// SPDX-License-Identifier: (GPL-2.0 or BSD-3-Clause)
/*
 *  Copyright(c) 2018 Broadcom
 */

/dts-v1/;

#include "omega-base-board.dtsi"
#include "bcm11407.dtsi"
#include "bcm95831x-svk-common.dtsi"

/ {
	model = "Broadcom Omega bcm95831x15k";

	sound {
		/* Use gpio 110 to control amp */
		brcm,ext-headset-amp-en-gpio = <&gpio_east 59 0>;
	};
};

