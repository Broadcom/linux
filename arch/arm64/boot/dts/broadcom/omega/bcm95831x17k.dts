// SPDX-License-Identifier: (GPL-2.0 or BSD-3-Clause)
/*
 *  Copyright(c) 2018 Broadcom
 */

/dts-v1/;

#include "arm/innolux-lcd-panel.dtsi"
#include "omega-base-board.dtsi"
#include "bcm58313.dtsi"
#include "bcm95831x-svk-common.dtsi"

#include <dt-bindings/gpio/gpio.h>

/ {
	model = "Broadcom Omega bcm95831x17k";
};

&iproc_dsi {
	dsi_panel = <&panel_innolux>;
	reset-gpio = <&gpio_west 36 GPIO_ACTIVE_LOW>;
	status = "okay";
};
