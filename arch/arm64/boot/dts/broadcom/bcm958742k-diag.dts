/*
 *  BSD LICENSE
 *
 *  Copyright(c) 2016 Broadcom.  All rights reserved.
 *
 *  Redistribution and use in source and binary forms, with or without
 *  modification, are permitted provided that the following conditions
 *  are met:
 *
 *    * Redistributions of source code must retain the above copyright
 *      notice, this list of conditions and the following disclaimer.
 *    * Redistributions in binary form must reproduce the above copyright
 *      notice, this list of conditions and the following disclaimer in
 *      the documentation and/or other materials provided with the
 *      distribution.
 *    * Neither the name of Broadcom Corporation nor the names of its
 *      contributors may be used to endorse or promote products derived
 *      from this software without specific prior written permission.
 *
 *  THIS SOFTWARE IS PROVIDED BY THE COPYRIGHT HOLDERS AND CONTRIBUTORS
 *  "AS IS" AND ANY EXPRESS OR IMPLIED WARRANTIES, INCLUDING, BUT NOT
 *  LIMITED TO, THE IMPLIED WARRANTIES OF MERCHANTABILITY AND FITNESS FOR
 *  A PARTICULAR PURPOSE ARE DISCLAIMED. IN NO EVENT SHALL THE COPYRIGHT
 *  OWNER OR CONTRIBUTORS BE LIABLE FOR ANY DIRECT, INDIRECT, INCIDENTAL,
 *  SPECIAL, EXEMPLARY, OR CONSEQUENTIAL DAMAGES (INCLUDING, BUT NOT
 *  LIMITED TO, PROCUREMENT OF SUBSTITUTE GOODS OR SERVICES; LOSS OF USE,
 *  DATA, OR PROFITS; OR BUSINESS INTERRUPTION) HOWEVER CAUSED AND ON ANY
 *  THEORY OF LIABILITY, WHETHER IN CONTRACT, STRICT LIABILITY, OR TORT
 *  (INCLUDING NEGLIGENCE OR OTHERWISE) ARISING IN ANY WAY OUT OF THE USE
 *  OF THIS SOFTWARE, EVEN IF ADVISED OF THE POSSIBILITY OF SUCH DAMAGE.
 */

/dts-v1/;

#include "stingray.dtsi"

/ {
	model = "Stingray Combo SVK (BCM958742k) Diagnostics";

	aliases {
		serial0 = &uart1;
		serial1 = &uart0;
		serial2 = &uart2;
		serial3 = &uart3;
	};

	chosen {
		bootargs = "console=ttyS0,115200n8 earlycon=uart8250, \
			    mmio32,0x66130000 maxcpus=2
			    mtdparts=brcmnand.0:10m(nboot),16m(kernel),1m(dt-blob),940m(nroot),32m(nand-test)";
	};

	memory {
		device_type = "memory";
		reg = <0x000000000 0x80000000 0x00000000 0x40000000>;
	};

	pcie_ss_syscon: syscon@40000000 {
		compatible = "syscon";
		reg = <0x0 0x40000000 0x0 0x1000>;
	};

	sdio0_vcc_en_reg: sdio0_en {
		compatible = "regulator-fixed";
		regulator-name = "sdio0_vcc_en-reg";
		regulator-min-microvolt = <3300000>;
		regulator-max-microvolt = <3300000>;
		gpio = <&pca9505 16 0>;
		enable-active-high;
	};

	sdio1_vcc_en_reg: sdio1_en {
		compatible = "regulator-fixed";
		regulator-name = "sdio1_vcc_en-reg";
		regulator-min-microvolt = <3300000>;
		regulator-max-microvolt = <3300000>;
		gpio = <&pca9505 17 0>;
		enable-active-high;
	};

	sdio0_vddo_ctrl_reg: sdio0_vddo_ctrl {
		compatible = "regulator-gpio";
		regulator-name = "sdio0_vddo_ctrl_reg";
		regulator-type = "voltage";
		regulator-min-microvolt = <1800000>;
		regulator-max-microvolt = <3300000>;
		gpios = <&pca9505 18 0>;
		states = <3300000 0x0
			  1800000 0x1>;
	};

	sdio1_vddo_ctrl_reg: sdio1_vddo_ctrl {
		compatible = "regulator-gpio";
		regulator-name = "sdio1_vddo_ctrl_reg";
		regulator-type = "voltage";
		regulator-min-microvolt = <1800000>;
		regulator-max-microvolt = <3300000>;
		gpios = <&pca9505 19 0>;
		states = <3300000 0x0
			  1800000 0x1>;
	};
};

&mdio_mux_iproc {
	mdio@0 {
		pci_phy0: phy@0 {
			compatible = "brcm,stingray-pcie-phy-prbs";
			reg = <0x0>;
			brcm,pcie-strap-syscon = <&pcie_ss_syscon>;
			status = "ok";
		};
		pci_phy1: phy@1 {
			compatible = "brcm,stingray-pcie-phy-prbs";
			reg = <0x1>;
			brcm,pcie-strap-syscon = <&pcie_ss_syscon>;
			status = "ok";
		};
		pci_phy2: phy@2 {
			compatible = "brcm,stingray-pcie-phy-prbs";
			reg = <0x2>;
			brcm,pcie-strap-syscon = <&pcie_ss_syscon>;
			status = "ok";
		};
		pci_phy3: phy@3 {
			compatible = "brcm,stingray-pcie-phy-prbs";
			reg = <0x3>;
			brcm,pcie-strap-syscon = <&pcie_ss_syscon>;
			status = "ok";
		};
		pci_phy4: phy@4 {
			compatible = "brcm,stingray-pcie-phy-prbs";
			reg = <0x4>;
			brcm,pcie-strap-syscon = <&pcie_ss_syscon>;
			status = "ok";
		};
		pci_phy5: phy@5 {
			compatible = "brcm,stingray-pcie-phy-prbs";
			reg = <0x5>;
			brcm,pcie-strap-syscon = <&pcie_ss_syscon>;
			status = "ok";
		};
		pci_phy6: phy@6 {
			compatible = "brcm,stingray-pcie-phy-prbs";
			reg = <0x6>;
			brcm,pcie-strap-syscon = <&pcie_ss_syscon>;
			status = "ok";
		};
		pci_phy7: phy@7 {
			compatible = "brcm,stingray-pcie-phy-prbs";
			reg = <0x7>;
			brcm,pcie-strap-syscon = <&pcie_ss_syscon>;
			status = "ok";
		};
	};

	mdio@11 {
		gphy0: eth-phy@1 {
			reg = <0x1>;
		};
	};
};

&pwm {
	status = "ok";
};

&i2c0 {
	status = "ok";

	pca9505: pca9505@20 {
		compatible = "nxp,pca9505";
		gpio-controller;
		#gpio-cells = <2>;
		reg = <0x20>;
	};
};

&i2c1 {
	status = "ok";
};

&uart0 {
	status = "ok";
};

&uart1 {
	status = "ok";
};

&uart2 {
	status = "ok";
};

&uart3 {
	status = "ok";
};

&ssp0 {
	pinctrl-0 = <&spi0_pins>;
	status = "ok";

	spi-flash@0 {
		#address-cells = <1>;
		#size-cells = <1>;
		compatible = "winbond,w25q32";
		reg = <0x0>;
		spi-max-frequency = <20000000>;

		partition@0 {				/* 2 MiB */
			label = "spi0-user";
			reg = <0x00000000 0x00200000>;
		};

		partition@200000 {			/* 2 MiB */
			label = "spi0-test";
			reg = <0x00200000 0x00200000>;
		};
	};
};

&ssp1 {
	pinctrl-0 = <&spi1_pins>;
	status = "ok";

	spi-flash@0 {
		#address-cells = <1>;
		#size-cells = <1>;
		compatible = "winbond,w25q32";
		reg = <0x0>;
		spi-max-frequency = <20000000>;

		partition@0 {				/* 2 MiB */
			label = "spi1-user";
			reg = <0x00000000 0x00200000>;
		};

		partition@200000 {			/* 2 MiB */
			label = "spi1-test";
			reg = <0x00200000 0x00200000>;
		};
	};
};

&nand {
	nandcs@0 {
		compatible = "brcm,nandcs";
		reg = <0>;
		nand-ecc-mode = "hw";
		nand-ecc-strength = <8>;
		nand-ecc-step-size = <512>;
		nand-bus-width = <16>;
		brcm,nand-oob-sector-size = <16>;
		#address-cells = <1>;
		#size-cells = <1>;
	};
};


&qspi {
	bspi-sel = <0>;
	flash: w25q64@0 {
		#address-cells = <1>;
		#size-cells = <1>;
		compatible = "jedec,spi-nor";
		reg = <0x0>;
		spi-max-frequency = <12500000>;

		partition@0 {
			label = "sf-boot";		/* 4 MiB */
			reg = <0x00000000 0x00400000>;
		};

		partition@400000 {			/* 2 MiB */
			label = "sf-user";
			reg = <0x00400000 0x00200000>;
		};

		partition@600000 {			/* 2 MiB */
			label = "sf-test";
			reg = <0x00600000 0x00200000>;
		};

	};
};

&enet {
	phy-mode = "rgmii";
	phy-handle = <&gphy0>;
};

&sdio0 {
	non-removable;
	vmmc-supply = <&sdio0_vcc_en_reg>;
	vqmmc-supply = <&sdio0_vddo_ctrl_reg>;
	status = "ok";
};

&sdio1 {
	vmmc-supply = <&sdio1_vcc_en_reg>;
	vqmmc-supply = <&sdio1_vddo_ctrl_reg>;
	status = "ok";
};

&sata_phy0 {
	compatible = "brcm,stingray-sata-phy-prbs";
};

&sata0_phy0 {
	status = "okay";
};

&sata_phy1 {
	compatible = "brcm,stingray-sata-phy-prbs";
};

&sata1_phy0 {
	status = "okay";
};

&sata_phy2 {
	compatible = "brcm,stingray-sata-phy-prbs";
};

&sata2_phy0 {
	status = "okay";
};

&sata_phy3 {
	compatible = "brcm,stingray-sata-phy-prbs";
};

&sata3_phy0 {
	status = "okay";
};

&sata_phy4 {
	compatible = "brcm,stingray-sata-phy-prbs";
};

&sata4_phy0 {
	status = "okay";
};

&sata_phy5 {
	compatible = "brcm,stingray-sata-phy-prbs";
};

&sata5_phy0 {
	status = "okay";
};

&sata_phy6 {
	compatible = "brcm,stingray-sata-phy-prbs";
};

&sata6_phy0 {
	status = "okay";
};

&sata_phy7 {
	compatible = "brcm,stingray-sata-phy-prbs";
};

&sata7_phy0 {
	status = "okay";
};

&sata_phy8 {
	compatible = "brcm,stingray-sata-phy-prbs";
};

&sata8_phy0 {
	status = "okay";
};

&sata_phy9 {
	compatible = "brcm,stingray-sata-phy-prbs";
};

&sata9_phy0 {
	status = "okay";
};

&sata_phy10 {
	compatible = "brcm,stingray-sata-phy-prbs";
};

&sata10_phy0 {
	status = "okay";
};

&sata_phy11 {
	compatible = "brcm,stingray-sata-phy-prbs";
};

&sata11_phy0 {
	status = "okay";
};

&sata_phy12 {
	compatible = "brcm,stingray-sata-phy-prbs";
};

&sata12_phy0 {
	status = "okay";
};

&sata_phy13 {
	compatible = "brcm,stingray-sata-phy-prbs";
};

&sata13_phy0 {
	status = "okay";
};

&sata_phy14 {
	compatible = "brcm,stingray-sata-phy-prbs";
};

&sata14_phy0 {
	status = "okay";
};

&sata_phy14 {
	compatible = "brcm,stingray-sata-phy-prbs";
};

&sata14_phy0 {
	status = "okay";
};

&sata_phy15 {
	compatible = "brcm,stingray-sata-phy-prbs";
};

&sata15_phy0 {
	status = "okay";
};

&sata_phy16 {
	compatible = "brcm,stingray-sata-phy-prbs";
};

&sata16_phy0 {
	status = "okay";
};

&sata_phy17 {
	compatible = "brcm,stingray-sata-phy-prbs";
};

&sata17_phy0 {
	status = "okay";
};

&sata_phy18 {
	compatible = "brcm,stingray-sata-phy-prbs";
};

&sata18_phy0 {
	status = "okay";
};

&sata_phy19 {
	compatible = "brcm,stingray-sata-phy-prbs";
};

&sata19_phy0 {
	status = "okay";
};

&xhci0 {
	status = "ok";
};

&xhci1 {
	status = "ok";
};

&bdc0 {
	status = "ok";
};

&bdc1 {
	status = "ok";
};

&usb0_phy0 {
	status = "ok";
};

&usb1_phy0 {
	status = "ok";
};

&usb1_phy1 {
	status = "ok";
};
