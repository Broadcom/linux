/*
 *  BSD LICENSE
 *
 *  Copyright(c) 2016 Broadcom.  All rights reserved.
 *
 *  Redistribution and use in source and binary forms, with or without
 *  modification, are permitted provided that the following conditions
 *  are met:
 *
 *    * Redistributions of source code must retain the above copyright
 *      notice, this list of conditions and the following disclaimer.
 *    * Redistributions in binary form must reproduce the above copyright
 *      notice, this list of conditions and the following disclaimer in
 *      the documentation and/or other materials provided with the
 *      distribution.
 *    * Neither the name of Broadcom Corporation nor the names of its
 *      contributors may be used to endorse or promote products derived
 *      from this software without specific prior written permission.
 *
 *  THIS SOFTWARE IS PROVIDED BY THE COPYRIGHT HOLDERS AND CONTRIBUTORS
 *  "AS IS" AND ANY EXPRESS OR IMPLIED WARRANTIES, INCLUDING, BUT NOT
 *  LIMITED TO, THE IMPLIED WARRANTIES OF MERCHANTABILITY AND FITNESS FOR
 *  A PARTICULAR PURPOSE ARE DISCLAIMED. IN NO EVENT SHALL THE COPYRIGHT
 *  OWNER OR CONTRIBUTORS BE LIABLE FOR ANY DIRECT, INDIRECT, INCIDENTAL,
 *  SPECIAL, EXEMPLARY, OR CONSEQUENTIAL DAMAGES (INCLUDING, BUT NOT
 *  LIMITED TO, PROCUREMENT OF SUBSTITUTE GOODS OR SERVICES; LOSS OF USE,
 *  DATA, OR PROFITS; OR BUSINESS INTERRUPTION) HOWEVER CAUSED AND ON ANY
 *  THEORY OF LIABILITY, WHETHER IN CONTRACT, STRICT LIABILITY, OR TORT
 *  (INCLUDING NEGLIGENCE OR OTHERWISE) ARISING IN ANY WAY OUT OF THE USE
 * OF THIS SOFTWARE, EVEN IF ADVISED OF THE POSSIBILITY OF SUCH DAMAGE.
 */

/dts-v1/;

/* HACK: Reserve initrd location
 * The memreserve entry for initrd is supposed
 * to be updated in DTB by bootloader before
 * handing over DTB to Linux kernel.
 */
/memreserve/ 0x75000000 0x00800000;
/* HACK: Reserve bl31 location
 * The memreserve entry for bl31 is supposed to
 * be updated in DTB by bootloader before handing
 * over DTB to Linux kernel. This is so because
 * only firmware (or bootloader) know the correct
 * location of bl31 and bl31 location can also
 * change in-future.
 */
/memreserve/ 0x77f00000 0x00100000;

#include "stingray.dtsi"

/ {
	model = "Stingray Combo SVK (BCM958742K) w/External SRAM";

	aliases {
		serial0 = &uart0;
		serial1 = &uart1;
		serial2 = &uart2;
		serial3 = &uart3;
	};

	chosen { /* HACK: hard-code kernel args and initrd location */
		bootargs = "root=/dev/ram rw console=ttyS1,115200n8 \
			    earlycon=uart8250,mmio32,0x68a10000 cma=8M maxcpus=2
			    mtdparts=brcmnand.0:10m(nboot),16m(kernel),1m(dt-blob),940m(nroot),32m(nand-test)";
		linux,stdout-path = "/soc/uart@68a10000:115200n8";
		linux,initrd-start = <0x0 0x75000000>;
		linux,initrd-end = <0x0 0x75800000>;
	};

	sdio0_vcc_en_reg: sdio0_en {
		compatible = "regulator-fixed";
		regulator-name = "sdio0_vcc_en-reg";
		regulator-min-microvolt = <3300000>;
		regulator-max-microvolt = <3300000>;
		gpio = <&pca9505 16 0>;
		enable-active-high;
	};

	sdio1_vcc_en_reg: sdio1_en {
		compatible = "regulator-fixed";
		regulator-name = "sdio1_vcc_en-reg";
		regulator-min-microvolt = <3300000>;
		regulator-max-microvolt = <3300000>;
		gpio = <&pca9505 17 0>;
		enable-active-high;
	};

	sdio0_vddo_ctrl_reg: sdio0_vddo_ctrl {
		compatible = "regulator-gpio";
		regulator-name = "sdio0_vddo_ctrl_reg";
		regulator-type = "voltage";
		regulator-min-microvolt = <1800000>;
		regulator-max-microvolt = <3300000>;
		gpios = <&pca9505 18 0>;
		states = <3300000 0x0
			  1800000 0x1>;
	};

	sdio1_vddo_ctrl_reg: sdio1_vddo_ctrl {
		compatible = "regulator-gpio";
		regulator-name = "sdio1_vddo_ctrl_reg";
		regulator-type = "voltage";
		regulator-min-microvolt = <1800000>;
		regulator-max-microvolt = <3300000>;
		gpios = <&pca9505 19 0>;
		states = <3300000 0x0
			  1800000 0x1>;
	};
};

&memory {
	reg = <0x00000000 0x74000000 0x0 0x04000000>; /* 64MB */
};


&uart0 {
	pinctrl-0 = <&uart0_pins>;
	status = "okay";
};

&uart1 {
	status = "okay";
};

&uart2 {
	status = "okay";
};

&uart3 {
	status = "okay";
};

&i2c0 {
	status = "okay";
	pca9505: pca9505@20 {
		compatible = "nxp,pca9505";
		gpio-controller;
		#gpio-cells = <2>;
		reg = <0x20>;
	};
};

&i2c1 {
	status = "okay";
	pcf8574: pcf8574@20 {
		compatible = "nxp,pcf8574a";
		gpio-controller;
		#gpio-cells = <2>;
		reg = <0x27>;
	};
};

&raid_mbox {
	status = "disabled";
};

&raid0 {
	status = "disabled";
};

&raid1 {
	status = "disabled";
};

&raid2 {
	status = "disabled";
};

&raid3 {
	status = "disabled";
};

&spu2 {
	status = "disabled";
};

&ssp0 {
	pinctrl-0 = <&spi0_pins>;
	cs-gpios = <&gpio_hsls 34 0>;
	status = "okay";

	spi-flash@0 {
		compatible = "jedec,spi-nor";
		reg = <0>;
		spi-max-frequency = <20000000>;
		#address-cells = <1>;
		#size-cells = <1>;

		partition@0 {				/* 2 MiB */
			label = "spi0-user";
			reg = <0x00000000 0x00200000>;
		};

		partition@200000 {			/* 2 MiB */
			label = "spi0-test";
			reg = <0x00200000 0x00200000>;
		};
	};
};

&ssp1 {
	pinctrl-0 = <&spi1_pins>;
	cs-gpios = <&gpio_hsls 96 0>;
	status = "okay";

	spi-flash@0 {
		compatible = "jedec,spi-nor";
		reg = <0>;
		spi-max-frequency = <20000000>;
		#address-cells = <1>;
		#size-cells = <1>;

		partition@0 {				/* 2 MiB */
			label = "spi1-user";
			reg = <0x00000000 0x00200000>;
		};

		partition@200000 {			/* 2 MiB */
			label = "spi1-test";
			reg = <0x00200000 0x00200000>;
		};
	};
};

&qspi {
	pinctrl-0 = <&qspi_pins>;
	bspi-sel = <0>;
	flash: w25q64@0 {
		#address-cells = <1>;
		#size-cells = <1>;
		compatible = "jedec,spi-nor";
		reg = <0x0>;
		spi-max-frequency = <12500000>;

		partition@0 {
			label = "sf-boot";		/* 4 MiB */
			reg = <0x00000000 0x00400000>;
		};

		partition@400000 {			/* 2 MiB */
			label = "sf-user";
			reg = <0x00400000 0x00200000>;
		};

		partition@600000 {			/* 2 MiB */
			label = "sf-test";
			reg = <0x00600000 0x00200000>;
		};

	};
};

&pwm {
	status = "okay";
};

&sdio0 {
	non-removable;
	vmmc-supply = <&sdio0_vcc_en_reg>;
	vqmmc-supply = <&sdio0_vddo_ctrl_reg>;
	status = "okay";
};

&sdio1 {
	vmmc-supply = <&sdio1_vcc_en_reg>;
	vqmmc-supply = <&sdio1_vddo_ctrl_reg>;
	status = "okay";
};

&sata_phy0 {
	compatible = "brcm,stingray-sata-phy-prbs";
};

&sata0_phy0 {
	status = "okay";
};

&sata_phy1 {
	compatible = "brcm,stingray-sata-phy-prbs";
};

&sata1_phy0 {
	status = "okay";
};

&sata_phy2 {
	compatible = "brcm,stingray-sata-phy-prbs";
};

&sata2_phy0 {
	status = "okay";
};

&sata_phy3 {
	compatible = "brcm,stingray-sata-phy-prbs";
};

&sata3_phy0 {
	status = "okay";
};

&sata_phy4 {
	compatible = "brcm,stingray-sata-phy-prbs";
};

&sata4_phy0 {
	status = "okay";
};

&sata_phy5 {
	compatible = "brcm,stingray-sata-phy-prbs";
};

&sata5_phy0 {
	status = "okay";
};

&sata_phy6 {
	compatible = "brcm,stingray-sata-phy-prbs";
};

&sata6_phy0 {
	status = "okay";
};

&sata_phy7 {
	compatible = "brcm,stingray-sata-phy-prbs";
};

&sata7_phy0 {
	status = "okay";
};

&sata_phy8 {
	compatible = "brcm,stingray-sata-phy-prbs";
};

&sata8_phy0 {
	status = "okay";
};

&sata_phy9 {
	compatible = "brcm,stingray-sata-phy-prbs";
};

&sata9_phy0 {
	status = "okay";
};

&sata_phy10 {
	compatible = "brcm,stingray-sata-phy-prbs";
};

&sata10_phy0 {
	status = "okay";
};

&sata_phy11 {
	compatible = "brcm,stingray-sata-phy-prbs";
};

&sata11_phy0 {
	status = "okay";
};

&sata_phy12 {
	compatible = "brcm,stingray-sata-phy-prbs";
};

&sata12_phy0 {
	status = "okay";
};

&sata_phy13 {
	compatible = "brcm,stingray-sata-phy-prbs";
};

&sata13_phy0 {
	status = "okay";
};

&sata_phy14 {
	compatible = "brcm,stingray-sata-phy-prbs";
};

&sata14_phy0 {
	status = "okay";
};

&sata_phy14 {
	compatible = "brcm,stingray-sata-phy-prbs";
};

&sata14_phy0 {
	status = "okay";
};

&sata_phy15 {
	compatible = "brcm,stingray-sata-phy-prbs";
};

&sata15_phy0 {
	status = "okay";
};

&sata_phy16 {
	compatible = "brcm,stingray-sata-phy-prbs";
};

&sata16_phy0 {
	status = "okay";
};

&sata_phy17 {
	compatible = "brcm,stingray-sata-phy-prbs";
};

&sata17_phy0 {
	status = "okay";
};

&sata_phy18 {
	compatible = "brcm,stingray-sata-phy-prbs";
};

&sata18_phy0 {
	status = "okay";
};

&sata_phy19 {
	compatible = "brcm,stingray-sata-phy-prbs";
};

&sata19_phy0 {
	status = "okay";
};
