// SPDX-License-Identifier: (GPL-2.0 or BSD-3-Clause)
/*
 *  Copyright(c) 2020 Broadcom
 */

#define ENABLE_PAXB_IOMMU 1
#define ENABLE_PAXC_IOMMU 1

#include "bcm958802a804x.dts"

/ {
	model = "Stingray PS225xx w/PCIE IOMMU (BCM958802A804x)";
};
