// SPDX-License-Identifier: (GPL-2.0 or BSD-3-Clause)
/*
 *  Copyright(c) 2019 Broadcom
 */

/dts-v1/;

#include "ns3-base.dtsi"

/ {
	model = "NS3 (BCM958742T)";
};

&gphy0 {
	enet-phy-lane-swap;
};
