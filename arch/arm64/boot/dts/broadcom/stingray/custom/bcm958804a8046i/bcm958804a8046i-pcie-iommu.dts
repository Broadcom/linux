// SPDX-License-Identifier: (GPL-2.0 or BSD-3-Clause)
/*
 *  Copyright(c) 2019 Broadcom
 */

#define ENABLE_PAXB_IOMMU 1
#define ENABLE_PAXC_IOMMU 1

#include "bcm958804a8046i.dts"

/ {
	model = "Stingray PS225N w/PCIE IOMMU (BCM958804A8046I)";
};
