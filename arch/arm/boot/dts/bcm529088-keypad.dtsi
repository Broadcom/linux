/*
 *  BSD LICENSE
 *
 *  Copyright(c) 2018 Broadcom.  All rights reserved.
 *
 *  Redistribution and use in source and binary forms, with or without
 *  modification, are permitted provided that the following conditions
 *  are met:
 *
 *    * Redistributions of source code must retain the above copyright
 *      notice, this list of conditions and the following disclaimer.
 *    * Redistributions in binary form must reproduce the above copyright
 *      notice, this list of conditions and the following disclaimer in
 *      the documentation and/or other materials provided with the
 *      distribution.
 *    * Neither the name of Broadcom nor the names of its
 *      contributors may be used to endorse or promote products derived
 *      from this software without specific prior written permission.
 *
 *  THIS SOFTWARE IS PROVIDED BY THE COPYRIGHT HOLDERS AND CONTRIBUTORS
 *  "AS IS" AND ANY EXPRESS OR IMPLIED WARRANTIES, INCLUDING, BUT NOT
 *  LIMITED TO, THE IMPLIED WARRANTIES OF MERCHANTABILITY AND FITNESS FOR
 *  A PARTICULAR PURPOSE ARE DISCLAIMED. IN NO EVENT SHALL THE COPYRIGHT
 *  OWNER OR CONTRIBUTORS BE LIABLE FOR ANY DIRECT, INDIRECT, INCIDENTAL,
 *  SPECIAL, EXEMPLARY, OR CONSEQUENTIAL DAMAGES (INCLUDING, BUT NOT
 *  LIMITED TO, PROCUREMENT OF SUBSTITUTE GOODS OR SERVICES; LOSS OF USE,
 *  DATA, OR PROFITS; OR BUSINESS INTERRUPTION) HOWEVER CAUSED AND ON ANY
 *  THEORY OF LIABILITY, WHETHER IN CONTRACT, STRICT LIABILITY, OR TORT
 *  (INCLUDING NEGLIGENCE OR OTHERWISE) ARISING IN ANY WAY OUT OF THE USE
 * OF THIS SOFTWARE, EVEN IF ADVISED OF THE POSSIBILITY OF SUCH DAMAGE.
 */

#include "dt-bindings/input/input.h"

&keypad {
	keypad,num-rows = <4>;
	keypad,num-columns = <4>;
	status = "okay";
	/*
	 * The row and column mapping is laid out so that 'D' is located at
	 * row 0, col 0, and '1' is at row 3, col 3:
	 *
	 *   D C B A
	 *   # 9 6 3
	 *   0 8 5 2
	 *   * 7 4 1
	 */
	linux,keymap = <
			MATRIX_KEY(0x00, 0x00, KEY_D) /* key_D */
			MATRIX_KEY(0x00, 0x01, KEY_C) /* key_C */
			MATRIX_KEY(0x00, 0x02, KEY_B) /* key_B */
			MATRIX_KEY(0x00, 0x03, KEY_A) /* key_A */
			MATRIX_KEY(0x01, 0x00, KEY_GRAVE) /* key_# */
			MATRIX_KEY(0x01, 0x01, KEY_9) /* key_9 */
			MATRIX_KEY(0x01, 0x02, KEY_6) /* key_6 */
			MATRIX_KEY(0x01, 0x03, KEY_3) /* key_3 */
			MATRIX_KEY(0x02, 0x00, KEY_0) /* key_0 */
			MATRIX_KEY(0x02, 0x01, KEY_8) /* key_8 */
			MATRIX_KEY(0x02, 0x02, KEY_5) /* key_5 */
			MATRIX_KEY(0x02, 0x03, KEY_2) /* key_2 */
			MATRIX_KEY(0x03, 0x00, KEY_KPASTERISK) /* key_* */
			MATRIX_KEY(0x03, 0x01, KEY_7) /* key_7 */
			MATRIX_KEY(0x03, 0x02, KEY_4) /* key_4 */
			MATRIX_KEY(0x03, 0x03, KEY_1) /* key_1 */
	>;
};

&pinctrl {
	keypad_on: keypad_on {
		function = "key";
		groups = "key0_grp", "key1_grp", "key2_grp",
			"key3_grp", "key8_grp", "key9_grp",
			"key10_grp", "key11_grp";
	};
};
