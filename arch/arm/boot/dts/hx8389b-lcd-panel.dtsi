/*
 * LCD module settings for HiMax HX8389B DSI Video mode display
 */

/ {
	panel_hx8389b: dsi_panel_hx8389b {
		brcm,module-name = "HX8389B";
		brcm,col-mod-i = <3>;
		brcm,col-mod-o = <2>;
		brcm,panel-width-mm = <54>;
		brcm,panel-height-mm = <95>;
		brcm,vmode;	/* Video mode display */
		brcm,fps = <30>;
		brcm,lanes = <2>;
		brcm,cmd-lp; /* Commands in LP mode*/
		brcm,hs-bitrate = <420000000>;
		brcm,lp-bitrate = <5000000>;

		brcm,dsi-timing = < 1 0 0 0 00 00 00 0 00 0 0 0x0000003F 1 1 0 0
			2 1 0 0 100000 00 00 0 00 0 0 0x00FFFFFF 0 0 0 0
			3 1 0 0 1000000 00 00 0 00 0 0 0x00FFFFFF 0 0 0 0
			4 2 0 0 1000000 00 00 0 00 0 0 0x00FFFFFF 1 1 0 0
			5 1 0 0 00 12 00 0 00 0 0 0x000001FF 0 0 0 0
			6 1 1 0 48 00 00 0 95 0 0 0x000001FF 0 0 0 0
			7 1 0 0 262 00 00 0 00 0 0 0x000001FF 0 0 0 0
			8 1 0 0 70 52 00 0 00 0 0 0x000001FF 0 0 0 0
			9 1 0 0 70 00 00 0 00 0 0 0x000001FF 0 0 0 0
			10 1 0 0 60 00 00 0 75 0 0 0x000001FF 0 0 0 0
			11 1 1 0 50 04 00 0 85 6 0 0x000001FF 0 0 0 0
			12 1 0 0 105 06 00 0 00 0 0 0x000001FF 0 0 0 0
			13 1 2 0 00 32 60 16 0 0 0 0x000001FF 0 0 0 0
			14 1 0 0 110 00 00 0 00 0 0 0x000001FF 0 0 0 0
			15 2 0 1 00 00 00 0 00 0 0 0x000000FF 1 1 0 0
			16 2 0 4 00 00 00 0 00 0 0 0x000000FF 1 1 0 0
			17 2 0 2 00 00 00 0 00 0 0 0x000000FF 1 1 0 0
			18 2 0 5 00 00 00 0 00 0 0 0x000000FF 1 1 0 0 >;
		brcm,scrn-on = [ 01 29
				00 00 ];
		brcm,scrn-off = [ 01 28
				00 00 ];
		brcm,slp-in = [ 01 28
				01 10
				04 78
				00 00 ];
		brcm,slp-out = [ 01 11
				04 78
				00 00 ];

		brcm,init-panel = [ 01 B9
				03 FF
				03 83
				03 89
				01 B1
				03 00
				03 00
				03 05
				03 E0
				03 90
				03 10
				03 11
				03 6F
				03 EF
				03 25
				03 2D
				03 22
				03 22
				03 43
				03 00
				03 5A
				03 F1
				03 20
				03 00
				01 B2
				03 00
				03 00
				03 78
				03 08
				03 03
				03 00
				03 F0
				01 B4
				03 90
				03 08
				03 00
				03 32
				03 10
				03 00
				03 00
				03 00
				03 00
				03 00
				03 00
				03 00
				03 37
				03 0A
				03 40
				03 04
				03 37
				03 0A
				03 48
				03 17
				03 59
				03 5E
				03 0A
				01 D5
				03 00
				03 00
				03 4C
				03 00
				03 01
				03 00
				03 00
				03 00
				03 60
				03 00
				03 99
				03 88
				03 99
				03 88
				03 88
				03 32
				03 88
				03 10
				03 88
				03 76
				03 88
				03 54
				03 10
				03 32
				03 88
				03 88
				03 88
				03 88
				03 88
				01 CB
				03 07
				03 07
				01 BB
				03 00
				03 00
				03 FF
				03 80
				01 B6
				03 00
				03 A1
				03 00
				03 A1
				01 C6
				03 08
				01 CC
				03 02
				01 DE
				03 05
				03 58
				03 10
				01 E0
				03 05
				03 0E
				03 12
				03 2D
				03 34
				03 3F
				03 18
				03 45
				03 09
				03 0A
				03 0F
				03 10
				03 13
				03 10
				03 15
				03 1A
				03 1C
				03 05
				03 0E
				03 12
				03 2D
				03 34
				03 3F
				03 18
				03 45
				03 09
				03 0A
				03 0F
				03 10
				03 13
				03 10
				03 15
				03 1A
				03 1C
				01 C1
				03 01
				03 00
				03 07
				03 1C
				03 2A
				03 34
				03 3F
				03 49
				03 52
				03 5B
				03 63
				03 6A
				03 71
				03 78
				03 7F
				03 85
				03 8B
				03 91
				03 97
				03 9D
				03 A3
				03 A8
				03 AF
				03 B5
				03 BE
				03 C6
				03 C9
				03 CD
				03 D7
				03 E1
				03 E6
				03 F1
				03 F7
				03 FF
				03 34
				03 CB
				03 4F
				03 D9
				03 54
				03 C8
				03 3C
				03 4A
				03 C0
				03 00
				03 07
				03 1C
				03 2A
				03 34
				03 3F
				03 49
				03 52
				03 5B
				03 63
				03 6A
				03 71
				03 78
				03 7F
				03 85
				03 8B
				03 91
				03 97
				03 9D
				03 A3
				03 A8
				03 AF
				03 B5
				03 BE
				03 C6
				03 C9
				03 CD
				03 D7
				03 E1
				03 E6
				03 F1
				03 F7
				03 FF
				03 34
				03 CB
				03 4F
				03 D9
				03 54
				03 C8
				03 3C
				03 4A
				03 C0
				03 00
				03 07
				03 1C
				03 2A
				03 34
				03 3F
				03 49
				03 52
				03 5B
				03 63
				03 6A
				03 71
				03 78
				03 7F
				03 85
				03 8B
				03 91
				03 97
				03 9D
				03 A3
				03 A8
				03 AF
				03 B5
				03 BE
				03 C6
				03 C9
				03 CD
				03 D7
				03 E1
				03 E6
				03 F1
				03 F7
				03 FF
				03 34
				03 CB
				03 4F
				03 D9
				03 54
				03 C8
				03 3C
				03 4A
				03 C0
				01 11
				04 96
				01 29
				04 0A
				00 00 ];
		panel-timing {
			clock-frequency = <1103347200>;
			hactive = <540>;
			vactive = <960>;
			hfront-porch = <22>;
			hback-porch = <20>;
			hsync-len = <8>;
			vfront-porch = <2>;
			vback-porch = <10>;
			vsync-len = <2>;
		};

	};
};
