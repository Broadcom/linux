/*
 *  BSD LICENSE
 *
 *  Copyright(c) 2017 Broadcom.  All rights reserved.
 *
 *  Redistribution and use in source and binary forms, with or without
 *  modification, are permitted provided that the following conditions
 *  are met:
 *
 *    * Redistributions of source code must retain the above copyright
 *      notice, this list of conditions and the following disclaimer.
 *    * Redistributions in binary form must reproduce the above copyright
 *      notice, this list of conditions and the following disclaimer in
 *      the documentation and/or other materials provided with the
 *      distribution.
 *    * Neither the name of Broadcom nor the names of its
 *      contributors may be used to endorse or promote products derived
 *      from this software without specific prior written permission.
 *
 *  THIS SOFTWARE IS PROVIDED BY THE COPYRIGHT HOLDERS AND CONTRIBUTORS
 *  "AS IS" AND ANY EXPRESS OR IMPLIED WARRANTIES, INCLUDING, BUT NOT
 *  LIMITED TO, THE IMPLIED WARRANTIES OF MERCHANTABILITY AND FITNESS FOR
 *  A PARTICULAR PURPOSE ARE DISCLAIMED. IN NO EVENT SHALL THE COPYRIGHT
 *  OWNER OR CONTRIBUTORS BE LIABLE FOR ANY DIRECT, INDIRECT, INCIDENTAL,
 *  SPECIAL, EXEMPLARY, OR CONSEQUENTIAL DAMAGES (INCLUDING, BUT NOT
 *  LIMITED TO, PROCUREMENT OF SUBSTITUTE GOODS OR SERVICES; LOSS OF USE,
 *  DATA, OR PROFITS; OR BUSINESS INTERRUPTION) HOWEVER CAUSED AND ON ANY
 *  THEORY OF LIABILITY, WHETHER IN CONTRACT, STRICT LIABILITY, OR TORT
 *  (INCLUDING NEGLIGENCE OR OTHERWISE) ARISING IN ANY WAY OUT OF THE USE
 *  OF THIS SOFTWARE, EVEN IF ADVISED OF THE POSSIBILITY OF SUCH DAMAGE.
 */

/* LCD module settings for HiMax HX8389C DSI Video mode display */

/ {
	panel_hx8389c: dsi_panel_hx8389c {
		brcm,module-name = "HX8389C";
		brcm,col-mod-i = <3>;
		brcm,col-mod-o = <2>;
		brcm,panel-width-mm = <54>;
		brcm,panel-height-mm = <95>;
		brcm,vmode;	/* Video mode display */
		brcm,fps = <30>;
		brcm,lanes = <2>;
		brcm,cmd-lp; /* Commands in LP mode*/
		brcm,hs-bitrate = <420000000>;
		brcm,lp-bitrate = <5000000>;

		brcm,dsi-timing = <0 0 0 0 00 00 00 00 00 0 0 0x0000003F 1 1 0 0
			1 1 0 0 1000000 00 00 00 00 0 0 0x00FFFFFF 0 0 0 0
			2 1 0 0 1000000 00 00 00 00 0 0 0x00FFFFFF 0 0 0 0
			3 2 0 0 1000000 00 00 00 00 0 0 0x00FFFFFF 1 1 0 0
			4 1 0 0 00 12 00 00 00 0 0 0x000001FF 0 0 0 0
			5 1 1 0 48 00 00 00 95 0 0 0x000001FF 0 0 0 0
			6 1 0 0 262 00 00 00 00 0 0 0x000001FF 0 0 0 0
			7 1 0 0 70 52 00 00 00 0 0 0x000001FF 0 0 0 0
			8 1 0 0 70 00 00 00 00 0 0 0x000001FF 0 0 0 0
			9 1 0 0 60 00 00 00 75 0 0 0x000001FF 0 0 0 0
			10 1 1 0 50 04 00 00 85 6 0 0x000001FF 0 0 0 0
			11 1 0 0 105 06 00 00 00 0 0 0x000001FF 0 0 0 0
			12 1 2 0 0 32 60 16 00 0 0 0x000001FF 0 0 0 0
			13 1 0 0 110 00 00 00 00 0 0 0x000001FF 0 0 0 0
			14 2 0 1 0 00 00 00 00 0 0 0x000000FF 1 1 0 0
			15 2 0 4 0 00 00 00 00 0 0 0x000000FF 1 1 0 0
			16 2 0 2 0 00 00 00 00 0 0 0x000000FF 1 1 0 0
			17 2 0 5 0 00 00 00 00 0 0 0x000000FF 1 1 0 0>;

		brcm,scrn-on = [ 01 29
				00 00 ];
		brcm,scrn-off = [ 01 28
				00 00 ];
		brcm,slp-in = [ 01 28
				01 10
				04 78
				00 00 ];
		brcm,slp-out = [ 01 11
				04 78
				00 00 ];
		brcm,init-panel = [ 01 B9
				03 FF
				03 83
				03 89
				01 B1
				03 7F
				03 10
				03 10
				03 F2
				03 32
				03 90
				03 10
				03 EC
				03 53
				03 80
				03 20
				03 20
				03 F8
				03 AA
				03 AA
				03 A1
				03 00
				03 80
				03 30
				03 00
				01 B2
				03 80
				03 50
				03 05
				03 07
				03 40
				03 38
				03 11
				03 64
				03 5D
				03 09
				01 B4
				03 70
				03 70
				03 70
				03 70
				03 00
				03 00
				03 10
				03 56
				03 10
				03 56
				03 B0
				01 D3
				03 00
				03 00
				03 00
				03 00
				03 00
				03 08
				03 00
				03 32
				03 10
				03 00
				03 00
				03 00
				03 03
				03 C6
				03 03
				03 C6
				03 00
				03 00
				03 00
				03 00
				03 35
				03 33
				03 04
				03 04
				03 37
				03 00
				03 00
				03 00
				03 05
				03 08
				03 00
				03 00
				03 0A
				03 00
				03 01
				01 D5
				03 18
				03 18
				03 18
				03 18
				03 19
				03 19
				03 18
				03 18
				03 20
				03 21
				03 24
				03 25
				03 18
				03 18
				03 18
				03 18
				03 00
				03 01
				03 04
				03 05
				03 02
				03 03
				03 06
				03 07
				03 18
				03 18
				03 18
				03 18
				03 18
				03 18
				03 18
				03 18
				03 18
				03 18
				03 18
				03 18
				03 18
				03 18
				01 D6
				03 18
				03 18
				03 18
				03 18
				03 18
				03 18
				03 19
				03 19
				03 25
				03 24
				03 21
				03 20
				03 18
				03 18
				03 18
				03 18
				03 07
				03 06
				03 03
				03 02
				03 05
				03 04
				03 01
				03 00
				03 18
				03 18
				03 18
				03 18
				03 18
				03 18
				03 18
				03 18
				03 18
				03 18
				03 18
				03 18
				03 18
				03 18
				01 BF
				03 B6
				03 43
				03 50
				03 E0
				01 C9
				03 1F
				03 2E
				03 00
				03 1E
				01 E0
				03 00
				03 05
				03 07
				03 33
				03 3A
				03 3F
				03 1C
				03 42
				03 08
				03 0B
				03 0E
				03 18
				03 0F
				03 12
				03 15
				03 13
				03 14
				03 06
				03 11
				03 13
				03 18
				03 00
				03 05
				03 07
				03 33
				03 3A
				03 3F
				03 1C
				03 42
				03 08
				03 0B
				03 0E
				03 18
				03 0E
				03 12
				03 14
				03 12
				03 13
				03 06
				03 11
				03 13
				03 18
				01 D2
				03 33
				01 CC
				03 02
				01 C7
				03 00
				03 80
				03 00
				03 C0
				01 B6
				03 6A
				03 6A
				03 00
				01 51
				03 FF
				01 53
				03 24
				01 55
				03 01
				01 5E
				03 00
				01 11
				04 96
				01 29
				04 0A
				00 00 ];

		panel-timing {
			clock-frequency = <1103347200>;
			hactive = <540>;
			vactive = <960>;
			hfront-porch = <22>;
			hback-porch = <20>;
			hsync-len = <8>;
			vfront-porch = <2>;
			vback-porch = <10>;
			vsync-len = <2>;
		};
	};
};
